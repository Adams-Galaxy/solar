## CMakeLists.txt
```
cmake_minimum_required(VERSION 3.20.0)

list(APPEND ZEPHYR_EXTRA_MODULES ${CMAKE_CURRENT_LIST_DIR}/../../..)

find_package(Zephyr REQUIRED HINTS $ENV{ZEPHYR_BASE})
project(solar_lifecycle LANGUAGES CXX)

target_sources(app PRIVATE src/main.cpp)
```

## prj.conf
```kconfig
CONFIG_CPP=y
CONFIG_STD_CPP23=y
CONFIG_REQUIRES_FULL_LIBCPP=y
CONFIG_ZTEST=y
CONFIG_CPP_EXCEPTIONS=n
CONFIG_CPP_RTTI=n
CONFIG_SOLAR=y
CONFIG_SOLAR_LIFECYCLE_REPORT_FAILURE_CAPACITY=2
```

## src/main.cpp
```c
#include <array>
#include <atomic>
#include <cstddef>

#include <zephyr/ztest.h>

#include "fixture.hpp"

namespace fixture = lifecycle_fixture;
namespace lifecycle = solar::lifecycle;

constexpr auto graph_components = solar::graph::components();
constexpr auto service_dependencies = solar::graph::dependencies<fixture::SuccessService>();
static_assert(graph_components.size() == 5);
static_assert(service_dependencies.size() == 1);
static_assert(service_dependencies[0].descriptor.name == "success.sensor");

template <typename Trace, std::size_t Size> void expect_trace(const std::array<int, Size>& expected)
{
    zassert_equal(Trace::count, Size);
    for (std::size_t index = 0; index < Size; ++index) {
        zassert_equal(Trace::values[index], expected[index]);
    }
}

ZTEST(solar_lifecycle, test_success_order_records_activation_stop_and_reboot_policy)
{
    fixture::SuccessTrace::reset();
    fixture::activation_committed.store(false, std::memory_order_release);
    fixture::execution_released.store(false, std::memory_order_release);
    fixture::transition_states_observed.store(true, std::memory_order_release);

    const auto boot = solar::boot();
    zassert_true(boot.has_value());
    zassert_equal(boot->initial_state, lifecycle::SystemState::Dormant);
    zassert_equal(boot->final_state, lifecycle::SystemState::Running);
    zassert_true(boot->initialization_completed);
    zassert_true(boot->start_completed);
    zassert_equal(boot->initialized_components, 5);
    zassert_equal(boot->started_components, 5);
    zassert_true(fixture::activation_committed.load(std::memory_order_acquire));
    zassert_true(fixture::execution_released.load(std::memory_order_acquire));
    zassert_true(fixture::transition_states_observed.load(std::memory_order_acquire));

    expect_trace<fixture::SuccessTrace>(std::array{10, 20, 30, 40, 11, 21, 31, 32, 41, 33, 34});

    const auto passive = lifecycle::record<fixture::SuccessPassive>();
    zassert_true(passive.has_value());
    zassert_equal(passive->state, lifecycle::ComponentState::Running);
    zassert_equal(passive->init.outcome, lifecycle::HookOutcome::NotPresent);
    zassert_equal(passive->start.outcome, lifecycle::HookOutcome::NotPresent);
    zassert_equal(passive->stop.outcome, lifecycle::HookOutcome::NotPresent);
    zassert_equal(passive->deinit.outcome, lifecycle::HookOutcome::NotPresent);

    const auto service = lifecycle::record<fixture::SuccessService>();
    zassert_true(service.has_value());
    zassert_equal(service->category, lifecycle::ComponentCategory::Service);
    zassert_true(service->execution_prepared);
    zassert_false(service->execution_contained);

    const auto records = lifecycle::components();
    zassert_true(records.has_value());
    zassert_equal(records->size(), 5);

    std::array<lifecycle::ComponentRecord, 2> page_storage{};
    const auto first_page = lifecycle::component_page(page_storage);
    zassert_true(first_page.has_value());
    zassert_equal(first_page->offset, 0);
    zassert_equal(first_page->count, 2);
    zassert_equal(first_page->total, 5);
    zassert_true(first_page->has_more());
    const auto final_page = lifecycle::component_page(page_storage, 4);
    zassert_true(final_page.has_value());
    zassert_equal(final_page->count, 1);
    zassert_false(final_page->has_more());
    zassert_equal(page_storage[0].descriptor.descriptor.name, "success.executor");
    zassert_equal(solar::status_of(lifecycle::component_page(page_storage, 6).error()),
                  solar::Status::Invalid);

    const auto retained_boot = lifecycle::boot_report();
    zassert_true(retained_boot.has_value());
    const auto rejected_running = solar::boot();
    zassert_false(rejected_running.has_value());
    zassert_equal(rejected_running.error().reason, lifecycle::BootErrorReason::AlreadyRunning);
    const auto still_retained = lifecycle::boot_report();
    zassert_true(still_retained.has_value());
    zassert_equal(still_retained->final_state, retained_boot->final_state);

    const auto stop = fixture::SuccessSystem::stop();
    zassert_true(stop.has_value());
    zassert_equal(stop->final_state, lifecycle::SystemState::Stopped);
    zassert_equal(stop->clean_exits, 2);
    zassert_equal(stop->stopped_components, 5);
    zassert_equal(stop->deinitialized_components, 5);
    expect_trace<fixture::SuccessTrace>(std::array{10, 20, 30, 40, 11, 21, 31, 32, 41, 33, 34,
                                                   35, 36, 42, 37, 22, 12, 43, 38, 23, 13});

    const auto rejected_stopped = solar::boot();
    zassert_false(rejected_stopped.has_value());
    zassert_equal(rejected_stopped.error().reason, lifecycle::BootErrorReason::RebootUnsupported);
    zassert_equal(lifecycle::state(), lifecycle::SystemState::Stopped);
}

ZTEST(solar_lifecycle, test_init_failure_rolls_back_only_earned_initialization)
{
    fixture::InitFailureTrace::reset();
    const auto boot = solar::boot<fixture::InitFailureApplication>();
    zassert_false(boot.has_value());
    zassert_equal(boot.error().reason, lifecycle::BootErrorReason::ComponentFailure);
    zassert_equal(boot.error().status, solar::Status::NotReady);
    expect_trace<fixture::InitFailureTrace>(std::array{1, 2, 3});

    const auto report = lifecycle::boot_report<fixture::InitFailureApplication>();
    zassert_true(report.has_value());
    zassert_true(report->rollback_attempted);
    zassert_true(report->rollback_completed);
    zassert_equal(report->initialized_components, 1);
    zassert_equal(report->final_state, lifecycle::SystemState::Failed);
    zassert_equal(report->primary_failure->operation, lifecycle::Operation::Init);

    const auto failed =
        lifecycle::record<fixture::InitFailureComponent, fixture::InitFailureApplication>();
    zassert_true(failed.has_value());
    zassert_equal(failed->init.outcome, lifecycle::HookOutcome::Failed);
    zassert_equal(failed->deinit.outcome, lifecycle::HookOutcome::NotAttempted);
    const auto skipped =
        lifecycle::record<fixture::InitFailureSkipped, fixture::InitFailureApplication>();
    zassert_true(skipped.has_value());
    zassert_equal(skipped->init.outcome, lifecycle::HookOutcome::NotAttempted);
}

ZTEST(solar_lifecycle, test_start_failure_preserves_primary_through_cleanup_failure)
{
    fixture::StartFailureTrace::reset();
    const auto boot = solar::boot<fixture::StartFailureApplication>();
    zassert_false(boot.has_value());
    zassert_equal(boot.error().reason, lifecycle::BootErrorReason::ComponentFailure);
    zassert_equal(boot.error().status, solar::Status::Invalid);
    zassert_equal(boot.error().failure->operation, lifecycle::Operation::Start);
    expect_trace<fixture::StartFailureTrace>(std::array{1, 2, 3, 4, 5, 6, 7});

    const auto report = lifecycle::boot_report<fixture::StartFailureApplication>();
    zassert_true(report.has_value());
    zassert_equal(report->primary_failure->status, solar::Status::Invalid);
    zassert_equal(report->cleanup_failures.total, 1);
    zassert_equal(report->cleanup_failures.entries[0].status, solar::Status::Error);
    zassert_false(report->cleanup_failures.entries[0].primary);

    const auto failed =
        lifecycle::record<fixture::StartFailureComponent, fixture::StartFailureApplication>();
    zassert_equal(failed->start.outcome, lifecycle::HookOutcome::Failed);
    zassert_equal(failed->stop.outcome, lifecycle::HookOutcome::NotAttempted);
    zassert_equal(failed->deinit.outcome, lifecycle::HookOutcome::Succeeded);
}

ZTEST(solar_lifecycle, test_stop_failure_continues_deinit_and_reports_abnormal_shutdown)
{
    fixture::StopFailureComponent::deinit_called = false;
    zassert_true(solar::boot<fixture::StopFailureApplication>().has_value());
    const auto stop = solar::stop<fixture::StopFailureApplication>();
    zassert_false(stop.has_value());
    zassert_equal(stop.error().reason, lifecycle::StopErrorReason::ShutdownFailed);
    zassert_true(fixture::StopFailureComponent::deinit_called);

    const auto report = lifecycle::stop_report<fixture::StopFailureApplication>();
    zassert_true(report.has_value());
    zassert_equal(report->failures.total, 1);
    zassert_equal(report->failures.entries[0].operation, lifecycle::Operation::Stop);
    zassert_equal(report->final_state, lifecycle::SystemState::Failed);
}

ZTEST(solar_lifecycle, test_execution_prepare_and_validation_failures_roll_back)
{
    fixture::PrepareFailureService::deinit_called = false;
    const auto prepare = solar::boot<fixture::PrepareFailureApplication>();
    zassert_false(prepare.has_value());
    zassert_equal(prepare.error().reason, lifecycle::BootErrorReason::ExecutionFailure);
    zassert_equal(prepare.error().failure->operation, lifecycle::Operation::PrepareExecution);
    zassert_true(fixture::PrepareFailureService::deinit_called);
    const auto prepare_record =
        lifecycle::record<fixture::PrepareFailureService, fixture::PrepareFailureApplication>();
    zassert_equal(prepare_record->stop.outcome, lifecycle::HookOutcome::NotAttempted);

    fixture::ValidateFailureService::stop_called = false;
    fixture::ValidateFailureService::deinit_called = false;
    const auto validate = solar::boot<fixture::ValidateFailureApplication>();
    zassert_false(validate.has_value());
    zassert_equal(validate.error().reason, lifecycle::BootErrorReason::ExecutionFailure);
    zassert_equal(validate.error().failure->operation, lifecycle::Operation::ValidateExecution);
    zassert_true(fixture::ValidateFailureService::stop_called);
    zassert_true(fixture::ValidateFailureService::deinit_called);
}

ZTEST(solar_lifecycle,
      test_uncontained_execution_preserves_dependency_and_cleans_independent_branch)
{
    fixture::PreservedResource::stop_called = false;
    fixture::PreservedResource::deinit_called = false;
    fixture::IndependentResource::stop_called = false;
    fixture::IndependentResource::deinit_called = false;

    zassert_true(solar::boot<fixture::UncontainedApplication>().has_value());
    const auto stop = solar::stop<fixture::UncontainedApplication>();
    zassert_false(stop.has_value());
    zassert_equal(stop.error().reason, lifecycle::StopErrorReason::ShutdownFailed);

    const auto report = lifecycle::stop_report<fixture::UncontainedApplication>();
    zassert_true(report.has_value());
    zassert_equal(report->uncontained_execution, 1);
    zassert_equal(report->preserved_dependencies, 1);
    zassert_equal(report->join_timeouts, 1);
    zassert_false(fixture::PreservedResource::stop_called);
    zassert_false(fixture::PreservedResource::deinit_called);
    zassert_true(fixture::IndependentResource::stop_called);
    zassert_true(fixture::IndependentResource::deinit_called);

    const auto preserved =
        lifecycle::record<fixture::PreservedResource, fixture::UncontainedApplication>();
    const auto service =
        lifecycle::record<fixture::UncontainedService, fixture::UncontainedApplication>();
    zassert_true(preserved->cleanup_blocked);
    zassert_true(service->cleanup_blocked);

    const auto retry = solar::stop<fixture::UncontainedApplication>();
    zassert_false(retry.has_value());
    zassert_equal(retry.error().reason, lifecycle::StopErrorReason::ShutdownFailed);
}

ZTEST(solar_lifecycle, test_forced_containment_is_abnormal_but_allows_cleanup)
{
    fixture::ForcedService::stop_called = false;
    fixture::ForcedService::deinit_called = false;
    zassert_true(solar::boot<fixture::ForcedApplication>().has_value());
    const auto stop = solar::stop<fixture::ForcedApplication>();
    zassert_false(stop.has_value());
    zassert_equal(stop.error().reason, lifecycle::StopErrorReason::ShutdownFailed);
    zassert_true(fixture::ForcedService::stop_called);
    zassert_true(fixture::ForcedService::deinit_called);

    const auto report = lifecycle::stop_report<fixture::ForcedApplication>();
    zassert_true(report.has_value());
    zassert_equal(report->forced_exits, 1);
    zassert_equal(report->join_timeouts, 1);
    zassert_equal(report->abort_attempts, 1);
    zassert_equal(report->uncontained_execution, 0);
    zassert_equal(report->preserved_dependencies, 0);
    zassert_equal(report->final_state, lifecycle::SystemState::Failed);
}

ZTEST(solar_lifecycle, test_report_capacity_truncates_summary_but_records_remain_queryable)
{
    static_assert(lifecycle::report_failure_capacity == 2);
    const auto boot = solar::boot<fixture::CapacityApplication>();
    zassert_false(boot.has_value());
    const auto report = lifecycle::boot_report<fixture::CapacityApplication>();
    zassert_true(report.has_value());
    zassert_equal(report->cleanup_failures.total, 3);
    zassert_equal(report->cleanup_failures.retained, 2);
    zassert_true(report->cleanup_failures.truncated());

    const auto one = lifecycle::record<fixture::CapacityOne, fixture::CapacityApplication>();
    const auto two = lifecycle::record<fixture::CapacityTwo, fixture::CapacityApplication>();
    const auto three = lifecycle::record<fixture::CapacityThree, fixture::CapacityApplication>();
    zassert_equal(one->deinit.outcome, lifecycle::HookOutcome::Failed);
    zassert_equal(two->deinit.outcome, lifecycle::HookOutcome::Failed);
    zassert_equal(three->deinit.outcome, lifecycle::HookOutcome::Failed);
}

ZTEST(solar_lifecycle, test_concurrent_boot_is_busy_and_transitions_are_queryable)
{
    fixture::concurrent_boot_succeeded.store(false, std::memory_order_release);
    solar::kernel::Thread<2048> thread;
    zassert_true(thread
                     .launch(&fixture::concurrent_boot_entry, nullptr,
                             {.priority = solar::kernel::Priority::preemptive<1>(),
                              .name = "lifecycle-boot"})
                     .has_value());
    zassert_true(fixture::ConcurrentComponent::entered
                     .take(solar::kernel::Timeout::after(std::chrono::milliseconds{100}))
                     .has_value());

    zassert_equal(lifecycle::state<fixture::ConcurrentApplication>(),
                  lifecycle::SystemState::Initializing);
    const auto record =
        lifecycle::record<fixture::ConcurrentComponent, fixture::ConcurrentApplication>();
    zassert_true(record.has_value());
    zassert_equal(record->state, lifecycle::ComponentState::Initializing);

    const auto rejected = solar::boot<fixture::ConcurrentApplication>();
    zassert_false(rejected.has_value());
    zassert_equal(rejected.error().reason, lifecycle::BootErrorReason::Busy);
    fixture::ConcurrentComponent::release.give();
    zassert_true(
        thread.join(solar::kernel::Timeout::after(std::chrono::milliseconds{100})).has_value());
    zassert_true(fixture::concurrent_boot_succeeded.load(std::memory_order_acquire));
    zassert_true(solar::stop<fixture::ConcurrentApplication>().has_value());
}

ZTEST(solar_lifecycle, test_empty_blueprint_has_a_complete_lifecycle)
{
    const solar::Result<solar::BootReport, solar::BootError> boot =
        solar::boot<fixture::EmptyApplication>();
    zassert_true(boot.has_value());
    zassert_equal(boot->initialized_components, 0);
    zassert_equal(boot->started_components, 0);

    const auto records = lifecycle::components<fixture::EmptyApplication>();
    zassert_true(records.has_value());
    zassert_true(records->empty());

    const solar::Result<solar::StopReport, solar::StopError> stop =
        solar::stop<fixture::EmptyApplication>();
    zassert_true(stop.has_value());
    zassert_equal(stop->stopped_components, 0);
    zassert_equal(stop->deinitialized_components, 0);
}

ZTEST_SUITE(solar_lifecycle, nullptr, nullptr, nullptr, nullptr, nullptr);
```

## src/fixture.hpp
```c
#pragma once

#include <array>
#include <atomic>
#include <chrono>
#include <cstddef>
#include <type_traits>

#include <solar/solar.hpp>

namespace lifecycle_fixture
{

template <typename Tag, std::size_t Capacity = 64> struct Trace
{
    inline static std::array<int, Capacity> values{};
    inline static std::size_t count{};

    static void reset() noexcept
    {
        count = 0;
        values.fill(0);
    }

    static void push(int value) noexcept
    {
        if (count < Capacity) {
            values[count++] = value;
        }
    }
};

struct SuccessTraceTag;
using SuccessTrace = Trace<SuccessTraceTag>;

struct SuccessCore
{
    static constexpr solar::component::Descriptor descriptor{.name = "success.core"};
    static solar::Result<void> init() noexcept;
    static solar::Result<void> start() noexcept;
    static solar::Result<void> stop() noexcept;
    static solar::Result<void> deinit() noexcept;
};

struct SuccessSensor
{
    static constexpr solar::component::Descriptor descriptor{.name = "success.sensor"};
    using Dependencies = solar::Dependencies<SuccessCore>;
    static solar::Result<void> init() noexcept;
    static solar::Result<void> start() noexcept;
    static solar::Result<void> stop() noexcept;
    static solar::Result<void> deinit() noexcept;
};

struct SuccessPassive
{
    static constexpr solar::component::Descriptor descriptor{.name = "success.passive"};
};

struct SuccessService
{
    static constexpr solar::component::Descriptor descriptor{.name = "success.service"};
    using Dependencies = solar::Dependencies<SuccessSensor>;
    static solar::Result<void> init() noexcept;
    static solar::Result<void> start() noexcept;
    static solar::Result<void> stop() noexcept;
    static solar::Result<void> deinit() noexcept;
};

struct SuccessExecutor
    : solar::execution::WorkQueue<"success.executor", solar::execution::StackSize<1024>>
{
    static constexpr solar::component::Descriptor descriptor{.name = "success.executor"};
    using Dependencies = solar::Dependencies<SuccessService>;
    static solar::Result<void> init() noexcept;
    static solar::Result<void> start() noexcept;
    static solar::Result<void> stop() noexcept;
    static solar::Result<void> deinit() noexcept;
};

using SuccessSystem = solar::System<
    solar::Blueprint<solar::Devices<SuccessSensor>, solar::Facilities<SuccessCore, SuccessPassive>,
                     solar::Services<SuccessService>, solar::Executors<SuccessExecutor>>>;

using ExpectedSuccessOrder =
    solar::TypeList<SuccessCore, SuccessSensor, SuccessPassive, SuccessService, SuccessExecutor>;
using ExpectedSuccessReverse =
    solar::TypeList<SuccessExecutor, SuccessService, SuccessPassive, SuccessSensor, SuccessCore>;
static_assert(
    std::is_same_v<typename SuccessSystem::Graph::TopologicalOrder, ExpectedSuccessOrder>);
static_assert(
    std::is_same_v<typename SuccessSystem::Graph::ReverseTopologicalOrder, ExpectedSuccessReverse>);

inline std::atomic_bool activation_committed{};
inline std::atomic_bool execution_released{};
inline std::atomic_bool transition_states_observed{};

struct InitFailureRoot
{
    static constexpr solar::component::Descriptor descriptor{.name = "init_failure.root"};
    static solar::Result<void> init() noexcept;
    static solar::Result<void> deinit() noexcept;
};

struct InitFailureComponent
{
    static constexpr solar::component::Descriptor descriptor{.name = "init_failure.failure"};
    using Dependencies = solar::Dependencies<InitFailureRoot>;
    static solar::Result<void> init() noexcept;
    static solar::Result<void> deinit() noexcept;
};

struct InitFailureSkipped
{
    static constexpr solar::component::Descriptor descriptor{.name = "init_failure.skipped"};
    static solar::Result<void> init() noexcept;
};

struct InitFailureTraceTag;
using InitFailureTrace = Trace<InitFailureTraceTag>;
using InitFailureSystem =
    solar::System<solar::Blueprint<solar::Devices<InitFailureComponent>,
                                   solar::Facilities<InitFailureRoot, InitFailureSkipped>>>;
struct InitFailureApplication;

struct StartFailureRoot
{
    static constexpr solar::component::Descriptor descriptor{.name = "start_failure.root"};
    static solar::Result<void> init() noexcept;
    static solar::Result<void> start() noexcept;
    static solar::Result<void> stop() noexcept;
    static solar::Result<void> deinit() noexcept;
};

struct StartFailureComponent
{
    static constexpr solar::component::Descriptor descriptor{.name = "start_failure.failure"};
    using Dependencies = solar::Dependencies<StartFailureRoot>;
    static solar::Result<void> init() noexcept;
    static solar::Result<void> start() noexcept;
    static solar::Result<void> stop() noexcept;
    static solar::Result<void> deinit() noexcept;
};

struct StartFailureTraceTag;
using StartFailureTrace = Trace<StartFailureTraceTag>;
using StartFailureSystem = solar::System<
    solar::Blueprint<solar::Devices<StartFailureComponent>, solar::Facilities<StartFailureRoot>>>;
struct StartFailureApplication;

struct StopFailureComponent
{
    static constexpr solar::component::Descriptor descriptor{.name = "stop_failure.component"};
    inline static bool deinit_called{};
    static solar::Result<void> init() noexcept
    {
        return {};
    }
    static solar::Result<void> start() noexcept
    {
        return {};
    }
    static solar::Result<void> stop() noexcept
    {
        return solar::fail<solar::Error>({.status = solar::Status::Error});
    }
    static solar::Result<void> deinit() noexcept
    {
        deinit_called = true;
        return {};
    }
};

using StopFailureSystem = solar::System<solar::Blueprint<solar::Facilities<StopFailureComponent>>>;
struct StopFailureApplication;

struct PrepareFailureService
{
    static constexpr solar::component::Descriptor descriptor{.name = "execution.prepare_failure"};
    inline static bool deinit_called{};
    static solar::Result<void> init() noexcept
    {
        return {};
    }
    static solar::Result<void> start() noexcept
    {
        return {};
    }
    static solar::Result<void> stop() noexcept
    {
        return {};
    }
    static solar::Result<void> deinit() noexcept
    {
        deinit_called = true;
        return {};
    }
};

using PrepareFailureSystem =
    solar::System<solar::Blueprint<solar::Services<PrepareFailureService>>>;
struct PrepareFailureApplication;

struct ValidateFailureService
{
    static constexpr solar::component::Descriptor descriptor{.name = "execution.validate_failure"};
    inline static bool stop_called{};
    inline static bool deinit_called{};
    static solar::Result<void> init() noexcept
    {
        return {};
    }
    static solar::Result<void> start() noexcept
    {
        return {};
    }
    static solar::Result<void> stop() noexcept
    {
        stop_called = true;
        return {};
    }
    static solar::Result<void> deinit() noexcept
    {
        deinit_called = true;
        return {};
    }
};

using ValidateFailureSystem =
    solar::System<solar::Blueprint<solar::Services<ValidateFailureService>>>;
struct ValidateFailureApplication;

struct PreservedResource
{
    static constexpr solar::component::Descriptor descriptor{.name = "uncontained.resource"};
    inline static bool stop_called{};
    inline static bool deinit_called{};
    static solar::Result<void> init() noexcept
    {
        return {};
    }
    static solar::Result<void> start() noexcept
    {
        return {};
    }
    static solar::Result<void> stop() noexcept
    {
        stop_called = true;
        return {};
    }
    static solar::Result<void> deinit() noexcept
    {
        deinit_called = true;
        return {};
    }
};

struct IndependentResource
{
    static constexpr solar::component::Descriptor descriptor{.name = "uncontained.independent"};
    inline static bool stop_called{};
    inline static bool deinit_called{};
    static solar::Result<void> init() noexcept
    {
        return {};
    }
    static solar::Result<void> start() noexcept
    {
        return {};
    }
    static solar::Result<void> stop() noexcept
    {
        stop_called = true;
        return {};
    }
    static solar::Result<void> deinit() noexcept
    {
        deinit_called = true;
        return {};
    }
};

struct UncontainedService
{
    static constexpr solar::component::Descriptor descriptor{.name = "uncontained.service"};
    using Dependencies = solar::Dependencies<PreservedResource>;
};

using UncontainedSystem =
    solar::System<solar::Blueprint<solar::Devices<PreservedResource, IndependentResource>,
                                   solar::Services<UncontainedService>>>;
struct UncontainedApplication;

struct ForcedService
{
    static constexpr solar::component::Descriptor descriptor{.name = "forced.service"};
    inline static bool stop_called{};
    inline static bool deinit_called{};
    static solar::Result<void> init() noexcept
    {
        return {};
    }
    static solar::Result<void> start() noexcept
    {
        return {};
    }
    static solar::Result<void> stop() noexcept
    {
        stop_called = true;
        return {};
    }
    static solar::Result<void> deinit() noexcept
    {
        deinit_called = true;
        return {};
    }
};

using ForcedSystem = solar::System<solar::Blueprint<solar::Services<ForcedService>>>;
struct ForcedApplication;

struct CapacityOne
{
    static constexpr solar::component::Descriptor descriptor{.name = "capacity.one"};
    static solar::Result<void> init() noexcept
    {
        return {};
    }
    static solar::Result<void> deinit() noexcept
    {
        return solar::fail<solar::Error>({.status = solar::Status::Error});
    }
};

struct CapacityTwo
{
    static constexpr solar::component::Descriptor descriptor{.name = "capacity.two"};
    static solar::Result<void> init() noexcept
    {
        return {};
    }
    static solar::Result<void> deinit() noexcept
    {
        return solar::fail<solar::Error>({.status = solar::Status::Error});
    }
};

struct CapacityThree
{
    static constexpr solar::component::Descriptor descriptor{.name = "capacity.three"};
    static solar::Result<void> init() noexcept
    {
        return {};
    }
    static solar::Result<void> deinit() noexcept
    {
        return solar::fail<solar::Error>({.status = solar::Status::Error});
    }
};

struct CapacityStartFailure
{
    static constexpr solar::component::Descriptor descriptor{.name = "capacity.start_failure"};
    static solar::Result<void> init() noexcept
    {
        return {};
    }
    static solar::Result<void> start() noexcept
    {
        return solar::fail<solar::Error>({.status = solar::Status::Invalid});
    }
};

using CapacitySystem = solar::System<solar::Blueprint<
    solar::Facilities<CapacityOne, CapacityTwo, CapacityThree, CapacityStartFailure>>>;
struct CapacityApplication;

struct ConcurrentComponent
{
    static constexpr solar::component::Descriptor descriptor{.name = "concurrent.component"};
    inline static solar::kernel::Semaphore entered{};
    inline static solar::kernel::Semaphore release{};
    static solar::Result<void> init() noexcept
    {
        entered.give();
        return release.take(solar::kernel::Timeout::after(std::chrono::milliseconds{500}));
    }
};

using ConcurrentSystem = solar::System<solar::Blueprint<solar::Facilities<ConcurrentComponent>>>;
struct ConcurrentApplication;
inline std::atomic_bool concurrent_boot_succeeded{};

using EmptySystem = solar::System<solar::Blueprint<>>;
struct EmptyApplication;

} // namespace lifecycle_fixture

SOLAR_BIND_SYSTEM(lifecycle_fixture::SuccessSystem);
SOLAR_BIND_SYSTEM_FOR(lifecycle_fixture::InitFailureApplication,
                      lifecycle_fixture::InitFailureSystem);
SOLAR_BIND_SYSTEM_FOR(lifecycle_fixture::StartFailureApplication,
                      lifecycle_fixture::StartFailureSystem);
SOLAR_BIND_SYSTEM_FOR(lifecycle_fixture::StopFailureApplication,
                      lifecycle_fixture::StopFailureSystem);
SOLAR_BIND_SYSTEM_FOR(lifecycle_fixture::PrepareFailureApplication,
                      lifecycle_fixture::PrepareFailureSystem);
SOLAR_BIND_SYSTEM_FOR(lifecycle_fixture::ValidateFailureApplication,
                      lifecycle_fixture::ValidateFailureSystem);
SOLAR_BIND_SYSTEM_FOR(lifecycle_fixture::UncontainedApplication,
                      lifecycle_fixture::UncontainedSystem);
SOLAR_BIND_SYSTEM_FOR(lifecycle_fixture::ForcedApplication, lifecycle_fixture::ForcedSystem);
SOLAR_BIND_SYSTEM_FOR(lifecycle_fixture::CapacityApplication, lifecycle_fixture::CapacitySystem);
SOLAR_BIND_SYSTEM_FOR(lifecycle_fixture::ConcurrentApplication,
                      lifecycle_fixture::ConcurrentSystem);
SOLAR_BIND_SYSTEM_FOR(lifecycle_fixture::EmptyApplication, lifecycle_fixture::EmptySystem);

template <>
struct solar::lifecycle::ExecutionProtocol<lifecycle_fixture::SuccessSystem,
                                           lifecycle_fixture::SuccessService>
{
    static constexpr bool participates = true;

    static solar::Result<void> prepare() noexcept
    {
        lifecycle_fixture::SuccessTrace::push(32);
        return {};
    }

    static solar::Result<void> validate_activation() noexcept
    {
        lifecycle_fixture::SuccessTrace::push(33);
        return {};
    }

    static void activate() noexcept
    {
        const auto records =
            solar::lifecycle::Engine<lifecycle_fixture::SuccessSystem>::components();
        bool all_running = records.has_value();
        if (records) {
            for (const auto& record : *records) {
                all_running =
                    all_running && record.state == solar::lifecycle::ComponentState::Running;
            }
        }
        lifecycle_fixture::activation_committed.store(
            all_running && solar::lifecycle::Engine<lifecycle_fixture::SuccessSystem>::state() ==
                               solar::lifecycle::SystemState::Running,
            std::memory_order_release);
        lifecycle_fixture::execution_released.store(true, std::memory_order_release);
        lifecycle_fixture::SuccessTrace::push(34);
    }

    static solar::Result<void> request_stop() noexcept
    {
        lifecycle_fixture::SuccessTrace::push(35);
        return {};
    }

    static solar::lifecycle::Containment contain() noexcept
    {
        lifecycle_fixture::SuccessTrace::push(36);
        return {};
    }
};

template <>
struct solar::lifecycle::ExecutionProtocol<lifecycle_fixture::PrepareFailureSystem,
                                           lifecycle_fixture::PrepareFailureService>
{
    static constexpr bool participates = true;
    static solar::Result<void> prepare() noexcept
    {
        return solar::fail<solar::Error>({.status = solar::Status::NoMemory});
    }
    static solar::Result<void> validate_activation() noexcept
    {
        return {};
    }
    static void activate() noexcept {}
    static solar::Result<void> request_stop() noexcept
    {
        return {};
    }
    static solar::lifecycle::Containment contain() noexcept
    {
        return {};
    }
};

template <>
struct solar::lifecycle::ExecutionProtocol<lifecycle_fixture::ValidateFailureSystem,
                                           lifecycle_fixture::ValidateFailureService>
{
    static constexpr bool participates = true;
    static solar::Result<void> prepare() noexcept
    {
        return {};
    }
    static solar::Result<void> validate_activation() noexcept
    {
        return solar::fail<solar::Error>({.status = solar::Status::Invalid});
    }
    static void activate() noexcept {}
    static solar::Result<void> request_stop() noexcept
    {
        return {};
    }
    static solar::lifecycle::Containment contain() noexcept
    {
        return {};
    }
};

template <>
struct solar::lifecycle::ExecutionProtocol<lifecycle_fixture::UncontainedSystem,
                                           lifecycle_fixture::UncontainedService>
{
    static constexpr bool participates = true;
    static solar::Result<void> prepare() noexcept
    {
        return {};
    }
    static solar::Result<void> validate_activation() noexcept
    {
        return {};
    }
    static void activate() noexcept {}
    static solar::Result<void> request_stop() noexcept
    {
        return {};
    }
    static solar::lifecycle::Containment contain() noexcept
    {
        return {.status = solar::Status::Timeout, .contained = false, .timed_out = true};
    }
};

template <>
struct solar::lifecycle::ExecutionProtocol<lifecycle_fixture::ForcedSystem,
                                           lifecycle_fixture::ForcedService>
{
    static constexpr bool participates = true;
    static solar::Result<void> prepare() noexcept
    {
        return {};
    }
    static solar::Result<void> validate_activation() noexcept
    {
        return {};
    }
    static void activate() noexcept {}
    static solar::Result<void> request_stop() noexcept
    {
        return {};
    }
    static solar::lifecycle::Containment contain() noexcept
    {
        return {.status = solar::Status::Ok,
                .contained = true,
                .forced = true,
                .timed_out = true,
                .abort_attempted = true};
    }
};

namespace lifecycle_fixture
{

template <typename Component>
inline void observe_success_transition(solar::lifecycle::SystemState system_state,
                                       solar::lifecycle::ComponentState component_state) noexcept
{
    const auto record = solar::lifecycle::Engine<SuccessSystem>::record<Component>();
    const bool observed = solar::lifecycle::Engine<SuccessSystem>::state() == system_state &&
                          record.has_value() && record->state == component_state;
    if (!observed) {
        transition_states_observed.store(false, std::memory_order_release);
    }
}

inline solar::Result<void> SuccessCore::init() noexcept
{
    observe_success_transition<SuccessCore>(solar::lifecycle::SystemState::Initializing,
                                            solar::lifecycle::ComponentState::Initializing);
    SuccessTrace::push(10);
    return {};
}
inline solar::Result<void> SuccessCore::start() noexcept
{
    observe_success_transition<SuccessCore>(solar::lifecycle::SystemState::Starting,
                                            solar::lifecycle::ComponentState::Starting);
    SuccessTrace::push(11);
    return {};
}
inline solar::Result<void> SuccessCore::stop() noexcept
{
    SuccessTrace::push(12);
    return {};
}
inline solar::Result<void> SuccessCore::deinit() noexcept
{
    SuccessTrace::push(13);
    return {};
}

inline solar::Result<void> SuccessSensor::init() noexcept
{
    SuccessTrace::push(20);
    return {};
}
inline solar::Result<void> SuccessSensor::start() noexcept
{
    SuccessTrace::push(21);
    return {};
}
inline solar::Result<void> SuccessSensor::stop() noexcept
{
    SuccessTrace::push(22);
    return {};
}
inline solar::Result<void> SuccessSensor::deinit() noexcept
{
    SuccessTrace::push(23);
    return {};
}

inline solar::Result<void> SuccessService::init() noexcept
{
    SuccessTrace::push(30);
    return {};
}
inline solar::Result<void> SuccessService::start() noexcept
{
    SuccessTrace::push(31);
    return {};
}
inline solar::Result<void> SuccessService::stop() noexcept
{
    SuccessTrace::push(37);
    return {};
}
inline solar::Result<void> SuccessService::deinit() noexcept
{
    SuccessTrace::push(38);
    return {};
}

inline solar::Result<void> SuccessExecutor::init() noexcept
{
    SuccessTrace::push(40);
    return {};
}
inline solar::Result<void> SuccessExecutor::start() noexcept
{
    SuccessTrace::push(41);
    return {};
}
inline solar::Result<void> SuccessExecutor::stop() noexcept
{
    observe_success_transition<SuccessExecutor>(solar::lifecycle::SystemState::Stopping,
                                                solar::lifecycle::ComponentState::Stopping);
    SuccessTrace::push(42);
    return {};
}
inline solar::Result<void> SuccessExecutor::deinit() noexcept
{
    observe_success_transition<SuccessExecutor>(solar::lifecycle::SystemState::Deinitializing,
                                                solar::lifecycle::ComponentState::Deinitializing);
    SuccessTrace::push(43);
    return {};
}

inline solar::Result<void> InitFailureRoot::init() noexcept
{
    InitFailureTrace::push(1);
    return {};
}
inline solar::Result<void> InitFailureRoot::deinit() noexcept
{
    InitFailureTrace::push(3);
    return {};
}
inline solar::Result<void> InitFailureComponent::init() noexcept
{
    InitFailureTrace::push(2);
    return solar::fail<solar::Error>({.status = solar::Status::NotReady});
}
inline solar::Result<void> InitFailureComponent::deinit() noexcept
{
    InitFailureTrace::push(99);
    return {};
}
inline solar::Result<void> InitFailureSkipped::init() noexcept
{
    InitFailureTrace::push(98);
    return {};
}

inline solar::Result<void> StartFailureRoot::init() noexcept
{
    StartFailureTrace::push(1);
    return {};
}
inline solar::Result<void> StartFailureRoot::start() noexcept
{
    StartFailureTrace::push(3);
    return {};
}
inline solar::Result<void> StartFailureRoot::stop() noexcept
{
    StartFailureTrace::push(5);
    return solar::fail<solar::Error>({.status = solar::Status::Error});
}
inline solar::Result<void> StartFailureRoot::deinit() noexcept
{
    StartFailureTrace::push(7);
    return {};
}
inline solar::Result<void> StartFailureComponent::init() noexcept
{
    StartFailureTrace::push(2);
    return {};
}
inline solar::Result<void> StartFailureComponent::start() noexcept
{
    StartFailureTrace::push(4);
    return solar::fail<solar::Error>({.status = solar::Status::Invalid});
}
inline solar::Result<void> StartFailureComponent::stop() noexcept
{
    StartFailureTrace::push(97);
    return {};
}
inline solar::Result<void> StartFailureComponent::deinit() noexcept
{
    StartFailureTrace::push(6);
    return {};
}

inline void concurrent_boot_entry(void*) noexcept
{
    const auto result = solar::boot<ConcurrentApplication>();
    concurrent_boot_succeeded.store(result.has_value(), std::memory_order_release);
}

} // namespace lifecycle_fixture
```
