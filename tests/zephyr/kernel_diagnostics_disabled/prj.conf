## CMakeLists.txt
```
cmake_minimum_required(VERSION 3.20.0)

list(APPEND ZEPHYR_EXTRA_MODULES ${CMAKE_CURRENT_LIST_DIR}/../../..)

find_package(Zephyr REQUIRED HINTS $ENV{ZEPHYR_BASE})
project(solar_kernel_diagnostics_disabled LANGUAGES CXX)

target_sources(app PRIVATE src/main.cpp)
```

## prj.conf
```kconfig
CONFIG_CPP=y
CONFIG_STD_CPP23=y
CONFIG_REQUIRES_FULL_LIBCPP=y
CONFIG_CPP_EXCEPTIONS=n
CONFIG_CPP_RTTI=n
CONFIG_SOLAR=y
CONFIG_ZTEST=y
# CONFIG_SOLAR_KERNEL_STACK_DIAGNOSTICS is not set
# CONFIG_SOLAR_KERNEL_RUNTIME_DIAGNOSTICS is not set
# CONFIG_SOLAR_KERNEL_THREAD_ENUMERATION is not set
# CONFIG_SOLAR_KERNEL_RUNTIME_STACK_SAFETY is not set
# CONFIG_INIT_STACKS is not set
# CONFIG_THREAD_STACK_INFO is not set
# CONFIG_THREAD_RUNTIME_STATS is not set
# CONFIG_THREAD_MONITOR is not set
```

## src/main.cpp
```c
#include <zephyr/ztest.h>

#include <solar/kernel.hpp>

static_assert(!solar::kernel::stack_diagnostics_available);
static_assert(!solar::kernel::runtime_diagnostics_available);
static_assert(!solar::kernel::thread_enumeration_available);
static_assert(!solar::kernel::runtime_stack_safety_available);

ZTEST(kernel_diagnostics_disabled, test_focused_queries_report_unsupported)
{
    const auto current = solar::kernel::this_thread::id();
    zassert_equal(solar::status_of(solar::kernel::stack_usage(current).error()),
                  solar::Status::NotSupported);
    zassert_equal(solar::status_of(solar::kernel::runtime_stats(current).error()),
                  solar::Status::NotSupported);
    zassert_equal(solar::status_of(solar::kernel::set_runtime_stats(current, true).error()),
                  solar::Status::NotSupported);
    zassert_equal(solar::status_of(solar::kernel::set_stack_warning_margin(current, 16).error()),
                  solar::Status::NotSupported);
    zassert_equal(solar::status_of(solar::kernel::check_stack_safety(current, true).error()),
                  solar::Status::NotSupported);
    zassert_equal(solar::status_of(solar::kernel::for_each_thread_locked(nullptr).error()),
                  solar::Status::NotSupported);
    zassert_equal(solar::status_of(solar::kernel::for_each_thread_unlocked(nullptr).error()),
                  solar::Status::NotSupported);
}

ZTEST_SUITE(kernel_diagnostics_disabled, nullptr, nullptr, nullptr, nullptr, nullptr);
```
