## CMakeLists.txt
```
cmake_minimum_required(VERSION 3.20.0)

list(APPEND ZEPHYR_EXTRA_MODULES ${CMAKE_CURRENT_LIST_DIR}/../../..)

find_package(Zephyr REQUIRED HINTS $ENV{ZEPHYR_BASE})
project(solar_hardware_compile_fail LANGUAGES CXX)

target_sources(app PRIVATE src/main.cpp)
target_compile_features(app PRIVATE cxx_std_23)
target_compile_definitions(app PRIVATE
    SOLAR_FAIL_CASE=0
    CONFIG_SOLAR_HARDWARE_SPI=1
    CONFIG_SOLAR_HARDWARE_I2C=1
    CONFIG_SOLAR_HARDWARE_UART=1
    CONFIG_SOLAR_HARDWARE_ADC=1
    CONFIG_SOLAR_HARDWARE_PWM=1)
set_target_properties(app PROPERTIES CXX_EXTENSIONS OFF)
set(CMAKE_EXPORT_COMPILE_COMMANDS ON)
```

## prj.conf
```kconfig
CONFIG_CPP=y
CONFIG_STD_CPP23=y
CONFIG_REQUIRES_FULL_LIBCPP=y
CONFIG_CPP_EXCEPTIONS=n
CONFIG_CPP_RTTI=n
CONFIG_COMPILER_WARNINGS_AS_ERRORS=y
CONFIG_GPIO=y
CONFIG_SERIAL=y
CONFIG_SOLAR=y
CONFIG_SOLAR_HARDWARE=y
CONFIG_SOLAR_HARDWARE_GENERATE_DEVICETREE=y
CONFIG_SOLAR_HARDWARE_GPIO=y
CONFIG_SOLAR_HARDWARE_GPIO_INTERRUPTS=y
```

## src/main.cpp
```c
#include <solar/hardware.hpp>

#if SOLAR_FAIL_CASE == 1
using Invalid = decltype(solar::hardware::dt::alias<"not-present">);
static_assert(sizeof(Invalid) != 0);
#elif SOLAR_FAIL_CASE == 2
using Invalid = solar::hardware::gpio::Output<solar::hardware::dt::chosen<"zephyr,console">>;
static_assert(sizeof(Invalid) != 0);
#elif SOLAR_FAIL_CASE == 3
using Invalid = solar::hardware::Endpoint<42>;
static_assert(sizeof(Invalid) != 0);
#elif SOLAR_FAIL_CASE == 4
using Invalid = solar::hardware::uart::Port<solar::hardware::dt::alias<"led0">>;
static_assert(sizeof(Invalid) != 0);
#elif SOLAR_FAIL_CASE == 5
inline constexpr auto UartSpec = solar::hardware::dt::device(
    DEVICE_DT_GET(DT_CHOSEN(zephyr_console)), solar::hardware::EndpointKind::Uart);
using Invalid = solar::hardware::uart::InterruptDriven<UartSpec>;
static_assert(sizeof(Invalid) != 0);
#elif SOLAR_FAIL_CASE == 6
using Invalid = solar::hardware::spi::Endpoint<solar::hardware::dt::alias<"led0">>;
static_assert(sizeof(Invalid) != 0);
#elif SOLAR_FAIL_CASE == 7
inline constexpr auto SpiSpec = solar::hardware::dt::spi(spi_dt_spec{});
using Spi = solar::hardware::spi::Endpoint<SpiSpec>;
using Invalid = Spi::Operation;
static_assert(sizeof(Invalid) != 0);
#elif SOLAR_FAIL_CASE == 8
inline constexpr auto PwmSpec = solar::hardware::dt::pwm(pwm_dt_spec{});
using Invalid = solar::hardware::pwm::Capture<PwmSpec>;
static_assert(sizeof(Invalid) != 0);
#elif SOLAR_FAIL_CASE == 9
inline constexpr auto AdcSpecA = solar::hardware::dt::adc(adc_dt_spec{
    .dev = DEVICE_DT_GET(DT_CHOSEN(zephyr_console)),
    .channel_id = 0,
    .resolution = 12,
});
inline constexpr auto AdcSpecB = solar::hardware::dt::adc(adc_dt_spec{
    .dev = DEVICE_DT_GET(DT_NODELABEL(gpio0)),
    .channel_id = 1,
    .resolution = 12,
});
using AdcA = solar::hardware::adc::Channel<AdcSpecA>;
using AdcB = solar::hardware::adc::Channel<AdcSpecB>;
using Invalid = solar::hardware::adc::Sequence<AdcA, AdcB>;
static_assert(sizeof(Invalid) != 0);
#elif SOLAR_FAIL_CASE == 10
inline constexpr auto I2cSpec = solar::hardware::dt::i2c(i2c_dt_spec{});
using I2c = solar::hardware::i2c::Endpoint<I2cSpec>;
using Invalid = I2c::Operation;
static_assert(sizeof(Invalid) != 0);
#else
using Valid = solar::hardware::gpio::Output<solar::hardware::dt::alias<"led0">>;
static_assert(Valid::descriptor().identity.endpoint_kind == solar::hardware::EndpointKind::Gpio);
#endif

int main()
{
    return 0;
}
```
