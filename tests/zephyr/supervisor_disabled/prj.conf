## CMakeLists.txt
```
cmake_minimum_required(VERSION 3.20.0)

list(APPEND ZEPHYR_EXTRA_MODULES ${CMAKE_CURRENT_LIST_DIR}/../../..)

find_package(Zephyr REQUIRED HINTS $ENV{ZEPHYR_BASE})
project(solar_supervisor_disabled LANGUAGES CXX)

target_sources(app PRIVATE src/main.cpp)
```

## prj.conf
```kconfig
CONFIG_CPP=y
CONFIG_STD_CPP23=y
CONFIG_REQUIRES_FULL_LIBCPP=y
CONFIG_CPP_EXCEPTIONS=n
CONFIG_CPP_RTTI=n
CONFIG_SOLAR=y
CONFIG_SOLAR_SUPERVISOR=n
CONFIG_ZTEST=y
```

## src/main.cpp
```c
#include <array>

#include <zephyr/ztest.h>

#include <solar/supervisor.hpp>

ZTEST(solar_supervisor_disabled, test_disabled_frontend_is_storage_free_and_explicit)
{
    static_assert(!solar::supervisor::available);
    static_assert(!solar::supervisor::enabled);

    auto state = solar::supervisor::state();
    auto watchdog = solar::supervisor::watchdog();
    std::array<solar::supervisor::ResponseRecord, 1> records{};
    auto responses = solar::supervisor::responses({}, records);
    zassert_false(state.has_value());
    zassert_false(watchdog.has_value());
    zassert_false(responses.has_value());
    zassert_equal(state.error().reason, solar::supervisor::Reason::Disabled);
}

ZTEST_SUITE(solar_supervisor_disabled, nullptr, nullptr, nullptr, nullptr, nullptr);
```
