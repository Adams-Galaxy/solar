## CMakeLists.txt
```
cmake_minimum_required(VERSION 3.20.0)

list(APPEND ZEPHYR_EXTRA_MODULES ${CMAKE_CURRENT_LIST_DIR}/../../..)

find_package(Zephyr REQUIRED HINTS $ENV{ZEPHYR_BASE})
project(solar_smoke LANGUAGES CXX)

target_sources(app PRIVATE src/main.cpp)
```

## prj.conf
```kconfig
CONFIG_CPP=y
CONFIG_STD_CPP23=y
CONFIG_REQUIRES_FULL_LIBCPP=y
CONFIG_ZTEST=y
CONFIG_SOLAR=y
```

## src/main.cpp
```c
#include <expected>

#include <zephyr/ztest.h>

#include <solar/solar.hpp>

static_assert(__cplusplus >= 202100L);
static_assert(solar::version == solar::Version{0, 1, 0});

ZTEST(solar_foundation, test_cpp23_expected_and_module_headers)
{
    std::expected<int, int> value{42};
    zassert_true(value.has_value());
    zassert_equal(value.value(), 42);
}

ZTEST_SUITE(solar_foundation, nullptr, nullptr, nullptr, nullptr, nullptr);
```
