## tests/zephyr/remote_output_stream_scheduler/testcase.yaml
```yaml
tests:
  solar.remote.output_stream_scheduler:
    tags:
      - solar
      - remote
      - protocol
    platform_allow:
      - native_sim/native/64
```

## tests/zephyr/remote_protocol/testcase.yaml
```yaml
tests:
  solar.remote.protocol:
    tags:
      - solar
      - remote
      - protocol
    platform_allow:
      - native_sim/native/64
```

## tests/zephyr/remote_push_queue/testcase.yaml
```yaml
tests:
  solar.remote.push_queue.relaxed:
    platform_allow:
      - native_sim/native/64
    integration_platforms:
      - native_sim/native/64
    tags:
      - solar
      - remote
      - queue
  solar.remote.push_queue.strict:
    platform_allow:
      - native_sim/native/64
    integration_platforms:
      - native_sim/native/64
    extra_configs:
      - CONFIG_SOLAR_STRICT_CATALOG_BINDING=y
    tags:
      - solar
      - remote
      - queue
      - strict
```

## tests/zephyr/remote_runtime/testcase.yaml
```yaml
tests:
  solar.remote.runtime.relaxed:
    platform_allow:
      - native_sim/native/64
    integration_platforms:
      - native_sim/native/64
    tags:
      - solar
      - remote
      - runtime
  solar.remote.runtime.strict:
    platform_allow:
      - native_sim/native/64
    integration_platforms:
      - native_sim/native/64
    extra_configs:
      - CONFIG_SOLAR_STRICT_CATALOG_BINDING=y
    tags:
      - solar
      - remote
      - runtime
      - strict
  solar.remote.runtime.introspection:
    platform_allow:
      - native_sim/native/64
    integration_platforms:
      - native_sim/native/64
    extra_configs:
      - CONFIG_SOLAR_REMOTE_RUNTIME_INTROSPECTION=y
      - CONFIG_SOLAR_INSPECTION=y
    tags:
      - solar
      - remote
      - runtime
      - introspection
```

## tests/zephyr/remote_topics/testcase.yaml
```yaml
tests:
  solar.remote.topics.relaxed:
    platform_allow:
      - native_sim/native/64
    integration_platforms:
      - native_sim/native/64
    tags:
      - solar
      - remote
      - topic
  solar.remote.topics.strict:
    platform_allow:
      - native_sim/native/64
    integration_platforms:
      - native_sim/native/64
    extra_configs:
      - CONFIG_SOLAR_STRICT_CATALOG_BINDING=y
    tags:
      - solar
      - remote
      - topic
      - strict
```

## tests/zephyr/smoke/testcase.yaml
```yaml
tests:
  solar.foundation:
    platform_allow:
      - native_sim/native/64
    tags:
      - solar
      - foundation
  solar.foundation.disabled:
    extra_configs:
      - CONFIG_SOLAR=n
    platform_allow:
      - native_sim/native/64
    tags:
      - solar
      - foundation
```

## tests/zephyr/supervisor/testcase.yaml
```yaml
tests:
  solar.supervisor.relaxed:
    platform_allow:
      - native_sim/native/64
    tags:
      - solar
      - supervisor
  solar.supervisor.strict:
    extra_configs:
      - CONFIG_SOLAR_STRICT_CATALOG_BINDING=y
    platform_allow:
      - native_sim/native/64
    tags:
      - solar
      - supervisor
      - strict
```

## tests/zephyr/supervisor_availability/testcase.yaml
```yaml
tests:
  solar.supervisor.availability.relaxed:
    platform_allow:
      - native_sim/native/64
    tags:
      - solar
      - supervisor
      - availability
  solar.supervisor.availability.strict:
    extra_configs:
      - CONFIG_SOLAR_STRICT_CATALOG_BINDING=y
    platform_allow:
      - native_sim/native/64
    tags:
      - solar
      - supervisor
      - availability
      - strict
```

## tests/zephyr/supervisor_disabled/testcase.yaml
```yaml
tests:
  solar.supervisor.disabled:
    platform_allow:
      - native_sim/native/64
    tags:
      - solar
      - supervisor
      - disabled
```

## tests/zephyr/system/testcase.yaml
```yaml
tests:
  solar.system.relaxed:
    platform_allow:
      - native_sim/native/64
    tags:
      - solar
      - system
      - relaxed
  solar.system.strict:
    extra_configs:
      - CONFIG_SOLAR_STRICT_CATALOG_BINDING=y
    platform_allow:
      - native_sim/native/64
    tags:
      - solar
      - system
      - strict
```

## zephyr/Kconfig
```kconfig
menuconfig SOLAR
	bool "Solar C++ framework"
	default y
	help
	  Enable Solar's modular C++23 facilities for Zephyr applications.

if SOLAR

menu "Application integration"

config SOLAR_APPLICATION_AUTO_INTEGRATION
	bool "Automatically integrate a Solar application manifest"
	default y
	help
	  Generate and attach the conventional application contract when the
	  configured project manifest exists. The default path is optional so
	  standalone Solar modules do not require an application manifest.

if SOLAR_APPLICATION_AUTO_INTEGRATION

config SOLAR_APPLICATION_PROJECT
	string "Application project manifest"
	default "solar.project.yaml"

config SOLAR_APPLICATION_LOCK
	string "Application interface lock"
	default "solar.interface.lock"

config SOLAR_APPLICATION_REQUIRE_LOCK
	bool "Require an existing interface lock"
	default y
	help
	  Normal builds never modify the identity lock. Use solar-codegen with
	  --update-lock when intentionally changing the interface.

config SOLAR_APPLICATION_GENERATE_PYTHON
	bool "Generate the typed Python application client"
	default y if SOLAR_REMOTE

config SOLAR_APPLICATION_GENERATE_SHIPMENT
	bool "Verify and package the linked application shipment"
	default y if SOLAR_REMOTE
	help
	  Requires linked Remote manifest generation when an application manifest
	  is present. The CMake integration diagnoses that requirement without
	  forcing it on standalone Remote users.

config SOLAR_APPLICATION_EXPLAIN
	bool "Generate application expansion reports"
	default y

config SOLAR_APPLICATION_DEFAULT_SERVICE_STACK
	int "Default service runner stack size"
	range 512 65536
	default 2048

choice SOLAR_APPLICATION_DEFAULT_SERVICE_PRIORITY_CLASS
	prompt "Default service runner priority class"
	default SOLAR_APPLICATION_DEFAULT_SERVICE_PRIORITY_PREEMPTIVE

config SOLAR_APPLICATION_DEFAULT_SERVICE_PRIORITY_PREEMPTIVE
	bool "Preemptive"

config SOLAR_APPLICATION_DEFAULT_SERVICE_PRIORITY_COOPERATIVE
	bool "Cooperative"

endchoice

config SOLAR_APPLICATION_DEFAULT_SERVICE_PRIORITY_LEVEL
	int "Default service runner priority level"
	range 0 255
	default 2
	help
	  Zero-based level within the selected Zephyr priority class. Solar validates
	  this value against CONFIG_NUM_PREEMPT_PRIORITIES or
	  CONFIG_NUM_COOP_PRIORITIES after Kconfig is resolved.

config SOLAR_APPLICATION_LOG_HISTORY_CAPACITY
	int "Retained structured log record capacity"
	range 1 1024
	default 24
	depends on SOLAR_LOG

endif # SOLAR_APPLICATION_AUTO_INTEGRATION

endmenu

config SOLAR_DESCRIPTOR_STRINGS
	bool "Retain descriptor strings"
	default y

config SOLAR_DIAGNOSTIC_DETAIL
	bool "Retain detailed diagnostics"
	default y

menu "Kernel integration"

config SOLAR_KERNEL_STACK_DIAGNOSTICS
	bool "Enable typed thread stack diagnostics"
	default n
	select INIT_STACKS
	select THREAD_STACK_INFO

config SOLAR_KERNEL_RUNTIME_DIAGNOSTICS
	bool "Enable typed thread runtime statistics"
	default n
	select THREAD_RUNTIME_STATS

config SOLAR_KERNEL_THREAD_ENUMERATION
	bool "Enable typed global thread enumeration"
	default n
	select THREAD_MONITOR

config SOLAR_KERNEL_RUNTIME_STACK_SAFETY
	bool "Enable runtime stack safety checks"
	default n
	select SOLAR_KERNEL_STACK_DIAGNOSTICS
	select THREAD_RUNTIME_STACK_SAFETY

config SOLAR_FATAL_BRIDGE
	bool "Install the Solar fatal error bridge"
	default n

endmenu

menu "Hardware"

config SOLAR_HARDWARE
	bool "Enable typed Zephyr hardware wrappers"
	default n

if SOLAR_HARDWARE

config SOLAR_HARDWARE_GENERATE_DEVICETREE
	bool "Generate ergonomic devicetree aliases"
	default y

config SOLAR_HARDWARE_GPIO
	bool "Enable GPIO wrappers"
	depends on GPIO
	default y

config SOLAR_HARDWARE_GPIO_INTERRUPTS
	bool "Enable GPIO interrupt ownership wrappers"
	depends on SOLAR_HARDWARE_GPIO
	default y

config SOLAR_HARDWARE_SPI
	bool "Enable SPI wrappers"
	depends on SPI
	default y

config SOLAR_HARDWARE_SPI_ASYNC
	bool "Enable asynchronous SPI operations"
	depends on SOLAR_HARDWARE_SPI && SPI_ASYNC
	default y

config SOLAR_HARDWARE_I2C
	bool "Enable I2C wrappers"
	depends on I2C
	default y

config SOLAR_HARDWARE_I2C_ASYNC
	bool "Enable callback-driven I2C operations"
	depends on SOLAR_HARDWARE_I2C && I2C_CALLBACK
	default y

config SOLAR_HARDWARE_UART
	bool "Enable UART wrappers"
	depends on SERIAL
	default y

config SOLAR_HARDWARE_UART_INTERRUPT
	bool "Enable interrupt-driven UART ownership wrappers"
	depends on SOLAR_HARDWARE_UART && UART_INTERRUPT_DRIVEN
	default y

config SOLAR_HARDWARE_UART_ASYNC
	bool "Enable asynchronous UART ownership wrappers"
	depends on SOLAR_HARDWARE_UART && UART_ASYNC_API
	default y

config SOLAR_HARDWARE_ADC
	bool "Enable ADC wrappers"
	depends on ADC
	default y

config SOLAR_HARDWARE_ADC_ASYNC
	bool "Enable asynchronous ADC reads"
	depends on SOLAR_HARDWARE_ADC && ADC_ASYNC
	default y

config SOLAR_HARDWARE_PWM
	bool "Enable PWM wrappers"
	depends on PWM
	default y

config SOLAR_HARDWARE_PWM_CAPTURE
	bool "Enable PWM capture wrappers"
	depends on SOLAR_HARDWARE_PWM && PWM_CAPTURE
	default y

config SOLAR_HARDWARE_COUNTER
	bool "Enable Counter wrappers"
	depends on COUNTER
	default y

config SOLAR_HARDWARE_WATCHDOG
	bool "Enable hardware Watchdog wrappers"
	depends on WATCHDOG
	default y

config SOLAR_HARDWARE_RTIO
	bool "Enable native RTIO adapters"
	depends on RTIO && (SPI_RTIO || I2C_RTIO || ADC_STREAM)
	default y

endif # SOLAR_HARDWARE

endmenu

menu "Structured logging"

config SOLAR_LOG
	bool "Enable Solar structured logging"
	default n
	help
	  Provide bounded, explicitly owned logging. Applications select sinks;
	  Solar does not replace Zephyr's logging frontend.

if SOLAR_LOG

config SOLAR_LOG_MAX_RECORD_BYTES
	int "Maximum encoded log payload bytes"
	range 64 4096
	default 384

config SOLAR_LOG_MAX_STRING_BYTES
	int "Maximum copied string argument size"
	range 1 1024
	default 96

config SOLAR_LOG_MAX_HEXDUMP_BYTES
	int "Maximum copied hexdump size"
	range 1 4096
	default 128

config SOLAR_LOG_RENDER_BUFFER_BYTES
	int "Bounded rendering buffer size"
	range 64 4096
	default 384

config SOLAR_LOG_ZEPHYR_BRIDGE
	bool "Forward native Zephyr log traffic into Solar sinks"
	depends on LOG
	select LOG_OUTPUT
	default n
	help
	  Registers a Zephyr log backend that relays every native Zephyr log
	  message (including from code with no Application binding, such as
	  the Remote byte engine) into this Application's Solar logger, under
	  one reserved Source. Zephyr's own logging remains fully usable
	  everywhere it always was; this only adds a second destination.

endif # SOLAR_LOG

endmenu

menu "Remote protocol"

config SOLAR_REMOTE
	bool "Solar typed Remote protocol"
	default n
	select COBS
	select CRC
	select ZCBOR
	select ZCBOR_CANONICAL

if SOLAR_REMOTE

config SOLAR_REMOTE_MAX_SCHEMAS
	int "Maximum effective Remote schemas"
	range 1 1024
	default 128

config SOLAR_REMOTE_MAX_ENDPOINTS
	int "Maximum Remote endpoints per identity domain"
	range 1 1024
	default 128

config SOLAR_REMOTE_MAX_FRAME_BYTES
	int "Maximum decoded protocol frame bytes"
	range 64 65535
	default 1024

config SOLAR_REMOTE_MAX_MESSAGE_BYTES
	int "Maximum logical message bytes"
	range 64 1048576
	default 8192

config SOLAR_REMOTE_MAX_SCHEMA_FIELDS
	int "Maximum fields in one schema"
	range 1 64
	default 32

config SOLAR_REMOTE_PACKED
	bool "Enable explicit packed stream schemas"
	default y

config SOLAR_REMOTE_GENERATE_MANIFEST
	bool "Generate host manifest artifacts after linking"
	default y

config SOLAR_REMOTE_EVENT_QUEUE_DEPTH
	int "Remote service event queue depth"
	range 4 256
	default 32

config SOLAR_REMOTE_SERVICE_STACK_SIZE
	int "Remote service stack size"
	range 1024 65536
	default 4096

config SOLAR_REMOTE_SERVICE_PRIORITY
	int "Remote service preemptive priority"
	range 0 15
	default 1

config SOLAR_REMOTE_RESPONSE_CACHE_BYTES
	int "Remote response cache bytes per link"
	range 64 8192
	default 512

config SOLAR_REMOTE_MAX_REQUESTS
	int "Maximum concurrently admitted Remote requests"
	range 1 128
	default 8

config SOLAR_REMOTE_MAX_INBOUND_WINDOW
	int "Maximum inbound stream window per link"
	range 1 64
	default 8

config SOLAR_REMOTE_REASSEMBLY_SLOTS
	int "Fragment reassembly slots per link"
	range 1 16
	default 2

config SOLAR_REMOTE_REASSEMBLY_TIMEOUT_MS
	int "Fragment reassembly timeout in milliseconds"
	range 1 60000
	default 1000

config SOLAR_REMOTE_OUTBOUND_MESSAGE_SLOTS
	int "Fragmented outbound messages per link"
	range 1 16
	default 2

config SOLAR_REMOTE_MAX_STREAM_RATE_HZ
	int "Maximum negotiated stream rate"
	range 1 1000000
	default 1000

config SOLAR_REMOTE_OUTPUT_LANES
	int
	default 5

config SOLAR_REMOTE_OUTPUT_LANE_DEPTH
	int "Queued frames per output lane"
	range 1 64
	default 4

config SOLAR_REMOTE_ISR_PUBLICATION
	bool "Enable constrained ISR publication"
	default n

config SOLAR_REMOTE_RUNTIME_INTROSPECTION
	bool "Enable bounded Remote runtime introspection"
	default n

config SOLAR_REMOTE_MANIFEST_RETRIEVAL
	bool "Allow bounded runtime manifest retrieval"
	default y

config SOLAR_REMOTE_BUILD_ID
	hex "Remote firmware build identity"
	default 0

endif # SOLAR_REMOTE

endmenu

endif # SOLAR
```
