## CMakeLists.txt
```
cmake_minimum_required(VERSION 3.20.0)
list(APPEND ZEPHYR_EXTRA_MODULES ${CMAKE_CURRENT_LIST_DIR}/../../..)
find_package(Zephyr REQUIRED HINTS $ENV{ZEPHYR_BASE})
project(solar_remote_disabled_tests LANGUAGES CXX)
target_sources(app PRIVATE src/main.cpp)
target_compile_features(app PRIVATE cxx_std_23)
set_target_properties(app PROPERTIES CXX_EXTENSIONS OFF)
```

## prj.conf
```kconfig
CONFIG_ZTEST=y
CONFIG_CPP=y
CONFIG_STD_CPP23=y
CONFIG_REQUIRES_FULL_LIBCPP=y
CONFIG_CPP_EXCEPTIONS=n
CONFIG_CPP_RTTI=n
CONFIG_COMPILER_WARNINGS_AS_ERRORS=y
CONFIG_SOLAR=y
```

## src/main.cpp
```c
#include <array>
#include <cstddef>

#include <zephyr/ztest.h>

#include <solar/remote.hpp>

static_assert(!solar::remote::available);

ZTEST(solar_remote_disabled, test_cbor_reports_disabled_without_runtime_storage)
{
    std::array<std::byte, 4> output{};
    auto encoded = solar::remote::cbor::encode(solar::Status::Ok, output);
    zassert_false(encoded.has_value());
    zassert_equal(encoded.error().reason, solar::remote::Reason::Disabled);
}

ZTEST_SUITE(solar_remote_disabled, nullptr, nullptr, nullptr, nullptr, nullptr);
```
