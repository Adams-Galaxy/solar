## CMakeLists.txt
```
cmake_minimum_required(VERSION 3.20.0)

list(APPEND ZEPHYR_EXTRA_MODULES ${CMAKE_CURRENT_LIST_DIR}/../../..)
find_package(Zephyr REQUIRED HINTS $ENV{ZEPHYR_BASE})
project(solar_health_compile_fail LANGUAGES CXX)

if(NOT DEFINED SOLAR_FAIL_CASE)
    message(FATAL_ERROR "SOLAR_FAIL_CASE must select the expected failure")
endif()

target_compile_definitions(app PRIVATE SOLAR_FAIL_CASE=${SOLAR_FAIL_CASE})
target_sources(app PRIVATE src/main.cpp)
```

## prj.conf
```kconfig
CONFIG_CPP=y
CONFIG_STD_CPP23=y
CONFIG_REQUIRES_FULL_LIBCPP=y
CONFIG_CPP_EXCEPTIONS=n
CONFIG_CPP_RTTI=n
CONFIG_SOLAR=y
CONFIG_SOLAR_HEALTH=y
CONFIG_SOLAR_STRICT_CATALOG_BINDING=y
```

## src/main.cpp
```c
#include <solar/solar.hpp>

using namespace solar::literals;

#if SOLAR_FAIL_CASE == 1
struct InvalidComponent
{
    static constexpr solar::component::Descriptor descriptor{.name = "invalid-assess"};
    struct Health
    {
        static bool assess()
        {
            return true;
        }
    };
};
#elif SOLAR_FAIL_CASE == 2
struct InvalidCheck
{
    static bool check()
    {
        return true;
    }
};
struct InvalidComponent
{
    static constexpr solar::component::Descriptor descriptor{.name = "invalid-check"};
    struct Health
    {
        using Checks = solar::health::Checks<InvalidCheck>;
    };
};
#elif SOLAR_FAIL_CASE == 3
struct InvalidComponent
{
    static constexpr solar::component::Descriptor descriptor{.name = "missing-progress"};
};
#elif SOLAR_FAIL_CASE == 4
struct InvalidComponent
{
    static constexpr solar::component::Descriptor descriptor{.name = "oversized-stack-margin"};
    using Execution = solar::execution::Service<solar::execution::StackSize<1024>>;
    struct Health
    {
        using Checks = solar::health::Checks<solar::health::StackMargin<2048>>;
    };
    static solar::Status run(solar::StopToken)
    {
        return solar::Status::Ok;
    }
};
#else
#error SOLAR_DIAGNOSTIC_UNKNOWN_HEALTH_FAILURE_CASE
#endif

#if SOLAR_FAIL_CASE == 4
using InvalidSystem = solar::System<solar::Blueprint<solar::Services<InvalidComponent>>>;
#else
using InvalidSystem = solar::System<solar::Blueprint<solar::Devices<InvalidComponent>>>;
#endif
SOLAR_BIND_SYSTEM(InvalidSystem);

int main()
{
#if SOLAR_FAIL_CASE == 1
    (void)solar::health::assess<InvalidComponent>();
#elif SOLAR_FAIL_CASE == 2
    (void)solar::health::check<InvalidComponent, InvalidCheck>();
#elif SOLAR_FAIL_CASE == 3
    (void)solar::health::progress<InvalidComponent>();
#elif SOLAR_FAIL_CASE == 4
    using Monitor = solar::health::OwnedMonitor<InvalidComponent, solar::health::StackMargin<2048>>;
    solar::health::detail::refresh_stack<InvalidSystem, Monitor>(0);
#endif
    return 0;
}
```
