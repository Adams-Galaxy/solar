## CMakeLists.txt
```
cmake_minimum_required(VERSION 3.20.0)

list(APPEND ZEPHYR_EXTRA_MODULES ${CMAKE_CURRENT_LIST_DIR}/../../..)

find_package(Zephyr REQUIRED HINTS $ENV{ZEPHYR_BASE})
project(solar_kernel_availability LANGUAGES CXX)

target_sources(app PRIVATE src/main.cpp)
```

## prj.conf
```kconfig
CONFIG_CPP=y
CONFIG_STD_CPP23=y
CONFIG_REQUIRES_FULL_LIBCPP=y
CONFIG_CPP_EXCEPTIONS=n
CONFIG_CPP_RTTI=n
CONFIG_SOLAR=y
CONFIG_ZTEST=y
# CONFIG_POLL is not set
# CONFIG_EVENTS is not set
CONFIG_NUM_MBOX_ASYNC_MSGS=0
```

## src/main.cpp
```c
#include <solar/kernel.hpp>

#include <zephyr/ztest.h>

static_assert(!solar::kernel::poll_available);
static_assert(!solar::kernel::event_flags_available);
static_assert(!solar::kernel::mailbox_async_available);

ZTEST(kernel_availability, test_remaining_primitives_work_without_optional_features)
{
    solar::kernel::Semaphore semaphore;
    semaphore.give();
    zassert_true(semaphore.try_take().has_value());

    solar::kernel::Mailbox mailbox;
    std::uint32_t payload{};
    const auto receive = mailbox.receive(payload, {}, solar::kernel::Timeout::no_wait());
    zassert_false(receive.has_value());
    zassert_equal(solar::status_of(receive.error()), solar::Status::WouldBlock);
}

ZTEST_SUITE(kernel_availability, nullptr, nullptr, nullptr, nullptr, nullptr);
```
