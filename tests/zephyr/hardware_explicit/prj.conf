## CMakeLists.txt
```
cmake_minimum_required(VERSION 3.20.0)

list(APPEND ZEPHYR_EXTRA_MODULES ${CMAKE_CURRENT_LIST_DIR}/../../..)

find_package(Zephyr REQUIRED HINTS $ENV{ZEPHYR_BASE})
project(solar_hardware_explicit_tests LANGUAGES CXX)

if(EXISTS ${BINARY_DIR_INCLUDE_GENERATED}/solar/hardware/generated/devicetree.hpp)
    message(FATAL_ERROR "Hardware generator output exists while generation is disabled")
endif()

target_sources(app PRIVATE src/main.cpp)
target_compile_features(app PRIVATE cxx_std_23)
set_target_properties(app PROPERTIES CXX_EXTENSIONS OFF)
```

## prj.conf
```kconfig
CONFIG_ZTEST=y
CONFIG_CPP=y
CONFIG_STD_CPP23=y
CONFIG_REQUIRES_FULL_LIBCPP=y
CONFIG_CPP_EXCEPTIONS=n
CONFIG_CPP_RTTI=n
CONFIG_COMPILER_WARNINGS_AS_ERRORS=y
CONFIG_GPIO=y
CONFIG_SOLAR=y
CONFIG_SOLAR_HARDWARE=y
CONFIG_SOLAR_HARDWARE_GENERATE_DEVICETREE=n
CONFIG_SOLAR_HARDWARE_GPIO=y
CONFIG_SOLAR_HARDWARE_GPIO_INTERRUPTS=n
```

## src/main.cpp
```c
#include <zephyr/drivers/gpio/gpio_emul.h>
#include <zephyr/ztest.h>

#include <solar/hardware/gpio.hpp>

inline constexpr auto LedSpec =
    solar::hardware::dt::gpio(GPIO_DT_SPEC_GET(DT_ALIAS(led0), gpios));
using Led = solar::hardware::gpio::Output<LedSpec>;

ZTEST(hardware_explicit, test_explicit_descriptor_without_generator)
{
    zassert_true(Led::ready());
    zassert_true(Led::configure().has_value());
    zassert_true(Led::activate().has_value());
    zassert_equal(gpio_emul_output_get_dt(&Led::native_handle()), 1);
}

ZTEST_SUITE(hardware_explicit, nullptr, nullptr, nullptr, nullptr, nullptr);
```
