## CMakeLists.txt
```
cmake_minimum_required(VERSION 3.20.0)
list(APPEND ZEPHYR_EXTRA_MODULES ${CMAKE_CURRENT_LIST_DIR}/../../..)
find_package(Zephyr REQUIRED HINTS $ENV{ZEPHYR_BASE})
project(solar_logging_compile_fail LANGUAGES CXX)
target_sources(app PRIVATE src/main.cpp)
target_compile_features(app PRIVATE cxx_std_23)
target_compile_definitions(app PRIVATE SOLAR_FAIL_CASE=0)
set_target_properties(app PROPERTIES CXX_EXTENSIONS OFF)
```

## prj.conf
```kconfig
CONFIG_CPP=y
CONFIG_STD_CPP23=y
CONFIG_REQUIRES_FULL_LIBCPP=y
CONFIG_CPP_EXCEPTIONS=n
CONFIG_CPP_RTTI=n
CONFIG_LOG=y
CONFIG_LOG_PRINTK=n
CONFIG_SOLAR=y
CONFIG_SOLAR_STRICT_CATALOG_BINDING=y
CONFIG_SOLAR_LOG=y
```

## src/main.cpp
```c
#include <solar/solar.hpp>

struct Registered
{
    static constexpr solar::component::Descriptor descriptor{.name = "registered"};
};

struct Unregistered
{
    static constexpr solar::log::SourceDescriptor descriptor{.name = "unregistered"};
};

struct UnregisteredDomain
{
    static constexpr solar::log::DomainDescriptor descriptor{.name = "unregistered-domain"};
};

struct InvalidSink
{
};

using CompileSystem = solar::System<solar::Blueprint<
    solar::Facilities<Registered>,
#if SOLAR_FAIL_CASE == 4
    solar::log::Configuration<solar::log::Sinks<solar::log::To<InvalidSink>>>
#else
    solar::log::Configuration<solar::log::Sinks<solar::log::To<solar::log::RetainedHistory>>>
#endif
    >>;

SOLAR_BIND_SYSTEM(CompileSystem);

#if SOLAR_FAIL_CASE == 1
auto result = solar::log::info<Unregistered>("bad source");
#elif SOLAR_FAIL_CASE == 2
auto result = solar::log::info<Registered>("missing {} argument");
#elif SOLAR_FAIL_CASE == 3
auto result = solar::log::info<Registered, UnregisteredDomain>("bad domain");
#elif SOLAR_FAIL_CASE == 4
static_assert(CompileSystem::valid);
#endif

int main()
{
    return 0;
}
```
