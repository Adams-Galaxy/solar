## CMakeLists.txt
```
cmake_minimum_required(VERSION 3.20.0)

list(APPEND ZEPHYR_EXTRA_MODULES ${CMAKE_CURRENT_LIST_DIR}/../../..)

find_package(Zephyr REQUIRED HINTS $ENV{ZEPHYR_BASE})
project(solar_inspection_compile_fail LANGUAGES CXX)

if(NOT DEFINED SOLAR_FAIL_CASE)
    set(SOLAR_FAIL_CASE 0)
endif()

target_compile_definitions(app PRIVATE SOLAR_FAIL_CASE=${SOLAR_FAIL_CASE})
target_sources(app PRIVATE src/main.cpp)
target_compile_features(app PRIVATE cxx_std_23)
set_target_properties(app PROPERTIES CXX_EXTENSIONS OFF)
```

## prj.conf
```kconfig
CONFIG_CPP=y
CONFIG_STD_CPP23=y
CONFIG_REQUIRES_FULL_LIBCPP=y
CONFIG_CPP_EXCEPTIONS=n
CONFIG_CPP_RTTI=n
CONFIG_SOLAR=y
CONFIG_SOLAR_EXECUTION=y
CONFIG_SOLAR_METRICS=n
CONFIG_SOLAR_REMOTE=n
CONFIG_SOLAR_INSPECTION=y
CONFIG_SOLAR_INSPECTION_MAX_COLLECTIONS=4
```

## src/main.cpp
```c
#include <array>

#include <solar/solar.hpp>

namespace fixture
{

struct ValidCollection
{
    using Record = std::uint32_t;
    using Query = solar::inspection::BasicQuery;
    static constexpr solar::inspection::Descriptor descriptor{
        .name = "valid",
        .stable_id = solar::inspection::Id{0xF1700101U},
        .maximum_page = 1,
        .record_size = sizeof(Record),
        .query_size = sizeof(Query),
    };
};

struct OtherCollection : ValidCollection
{
    static constexpr solar::inspection::Descriptor descriptor{
        .name = "other",
        .stable_id = solar::inspection::Id{0xF1700102U},
        .maximum_page = 1,
        .record_size = sizeof(Record),
        .query_size = sizeof(Query),
    };
};

#if SOLAR_FAIL_CASE == 1
struct InvalidCollection
{
    using Query = solar::inspection::BasicQuery;
    static constexpr solar::inspection::Descriptor descriptor{
        .name = "invalid",
        .stable_id = solar::inspection::Id{0xF1700103U},
        .maximum_page = 1,
        .record_size = 1,
        .query_size = sizeof(Query),
    };
};
using SelectedCollection = InvalidCollection;
#else
using SelectedCollection = ValidCollection;
#endif

struct Component
{
#if SOLAR_FAIL_CASE == 4
    using Inspections = solar::inspection::Collections<SelectedCollection, OtherCollection>;
#elif SOLAR_FAIL_CASE == 1 || SOLAR_FAIL_CASE == 2
    using Inspections = solar::inspection::Collections<SelectedCollection>;
#endif
    static constexpr solar::component::Descriptor descriptor{.name = "component"};
};

using System = solar::System<solar::Blueprint<solar::Facilities<Component>>>;

} // namespace fixture

SOLAR_BIND_SYSTEM(fixture::System);

#if SOLAR_FAIL_CASE == 2
void provider_missing()
{
    std::array<fixture::ValidCollection::Record, 1> output{};
    (void)solar::inspection::query<fixture::ValidCollection>({}, output);
}
#elif SOLAR_FAIL_CASE == 3
void collection_missing()
{
    std::array<fixture::OtherCollection::Record, 1> output{};
    (void)solar::inspection::query<fixture::OtherCollection>({}, output);
}
#endif

int main()
{
    return fixture::System::valid ? 0 : 1;
}
```
