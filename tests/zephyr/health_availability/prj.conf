## CMakeLists.txt
```
cmake_minimum_required(VERSION 3.20.0)

list(APPEND ZEPHYR_EXTRA_MODULES ${CMAKE_CURRENT_LIST_DIR}/../../..)
find_package(Zephyr REQUIRED HINTS $ENV{ZEPHYR_BASE})
project(solar_health_availability LANGUAGES CXX)
target_sources(app PRIVATE src/main.cpp)
```

## prj.conf
```kconfig
CONFIG_CPP=y
CONFIG_STD_CPP23=y
CONFIG_REQUIRES_FULL_LIBCPP=y
CONFIG_CPP_EXCEPTIONS=n
CONFIG_CPP_RTTI=n
CONFIG_SOLAR=y
CONFIG_SOLAR_HEALTH=y
CONFIG_ZTEST=y
```

## src/main.cpp
```c
#include <zephyr/ztest.h>

#include <solar/solar.hpp>

struct Probe
{
    static constexpr solar::component::Descriptor descriptor{.name = "probe"};
};

using ProbeSystem = solar::System<solar::Blueprint<solar::Devices<Probe>>>;
SOLAR_BIND_SYSTEM(ProbeSystem);

ZTEST(solar_health_availability, test_binding_window)
{
    auto early = solar::health::report<Probe>(solar::health::nominal());
    zassert_false(early.has_value());
    zassert_equal(early.error().reason, solar::health::Reason::NotReady);

    zassert_true(ProbeSystem::boot().has_value());
    zassert_true(solar::health::report<Probe>(solar::health::nominal()).has_value());
    zassert_true(ProbeSystem::stop().has_value());
}

ZTEST_SUITE(solar_health_availability, nullptr, nullptr, nullptr, nullptr, nullptr);
```
