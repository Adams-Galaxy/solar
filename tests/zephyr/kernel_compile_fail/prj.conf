## CMakeLists.txt
```
cmake_minimum_required(VERSION 3.20.0)

list(APPEND ZEPHYR_EXTRA_MODULES ${CMAKE_CURRENT_LIST_DIR}/../../..)

find_package(Zephyr REQUIRED HINTS $ENV{ZEPHYR_BASE})
project(solar_kernel_compile_fail LANGUAGES CXX)

if(NOT DEFINED SOLAR_FAIL_CASE)
    message(FATAL_ERROR "SOLAR_FAIL_CASE must select the expected failure")
endif()

target_compile_definitions(app PRIVATE SOLAR_FAIL_CASE=${SOLAR_FAIL_CASE})
target_sources(app PRIVATE src/main.cpp)
```

## prj.conf
```kconfig
CONFIG_CPP=y
CONFIG_STD_CPP23=y
CONFIG_REQUIRES_FULL_LIBCPP=y
CONFIG_CPP_EXCEPTIONS=n
CONFIG_CPP_RTTI=n
CONFIG_SOLAR=y
# CONFIG_POLL is not set
# CONFIG_EVENTS is not set
```

## src/main.cpp
```c
#include <string>

#include <solar/application/priority.hpp>
#include <solar/kernel.hpp>

#if SOLAR_FAIL_CASE == 1
solar::kernel::MessageQueue<std::string, 2> invalid_queue;
#elif SOLAR_FAIL_CASE == 2
solar::kernel::MessageQueue<std::uint32_t, 0> invalid_queue;
#elif SOLAR_FAIL_CASE == 3
constexpr auto invalid_priority =
    solar::kernel::Priority::preemptive<CONFIG_NUM_PREEMPT_PRIORITIES>();
#elif SOLAR_FAIL_CASE == 4
solar::kernel::PollSet<1> unavailable_poll;
#elif SOLAR_FAIL_CASE == 5
solar::kernel::EventFlags unavailable_events;
#elif SOLAR_FAIL_CASE == 6
solar::kernel::Thread<0> invalid_thread;
#elif SOLAR_FAIL_CASE == 7
solar::kernel::WorkQueue<0> invalid_work_queue;
#elif SOLAR_FAIL_CASE == 8
solar::kernel::MemorySlab<0, 1> invalid_slab;
#elif SOLAR_FAIL_CASE == 9
solar::kernel::MemorySlab<16, 0> invalid_slab;
#elif SOLAR_FAIL_CASE == 10
solar::kernel::MemorySlab<16, 1, 3> invalid_slab;
#elif SOLAR_FAIL_CASE == 11
solar::kernel::Pipe<0> invalid_pipe;
#elif SOLAR_FAIL_CASE == 12
constexpr auto invalid_priority =
    solar::kernel::Priority::cooperative<CONFIG_NUM_COOP_PRIORITIES>();
#elif SOLAR_FAIL_CASE == 13
constexpr auto invalid_priority =
    solar::kernel::Priority::native<K_HIGHEST_APPLICATION_THREAD_PRIO - 1>();
#elif SOLAR_FAIL_CASE == 14
constexpr auto invalid_priority =
    solar::kernel::Priority::native<K_LOWEST_APPLICATION_THREAD_PRIO + 1>();
#elif SOLAR_FAIL_CASE == 15 && CONFIG_NUM_METAIRQ_PRIORITIES > 0
constexpr auto invalid_priority =
    solar::kernel::Priority::meta_irq<CONFIG_NUM_METAIRQ_PRIORITIES>();
#elif SOLAR_FAIL_CASE == 16
constexpr auto invalid_priority =
    solar::PreemptivePriority<CONFIG_NUM_PREEMPT_PRIORITIES>::resolve();
#elif SOLAR_FAIL_CASE == 17
constexpr auto invalid_priority = solar::CooperativePriority<CONFIG_NUM_COOP_PRIORITIES>::resolve();
#elif SOLAR_FAIL_CASE == 18
void invalid_native_access(solar::kernel::Mutex& mutex)
{
    (void)mutex.native_handle();
}
#elif SOLAR_FAIL_CASE == 19
void invalid_native_access(solar::kernel::Thread<1024>& thread)
{
    (void)thread.native_handle();
}
#elif SOLAR_FAIL_CASE == 20
void invalid_native_access(solar::kernel::WorkQueue<1024>& queue)
{
    (void)queue.native_handle();
}
#elif SOLAR_FAIL_CASE == 21
void invalid_native_access(solar::kernel::Timer& timer)
{
    (void)timer.native_handle();
}
#elif SOLAR_FAIL_CASE == 22
void invalid_native_access(solar::kernel::ConditionVariable& condition)
{
    (void)condition.native_handle();
}
#elif SOLAR_FAIL_CASE == 23
void invalid_native_access(solar::kernel::Pipe<16>& pipe)
{
    (void)pipe.native_handle();
}
#elif SOLAR_FAIL_CASE == 24
void invalid_native_access(solar::kernel::MemorySlab<16, 2>& slab)
{
    (void)slab.native_handle();
}
#elif SOLAR_FAIL_CASE == 25
void invalid_native_access(solar::kernel::SpinLock& lock)
{
    (void)lock.native_handle();
}
#elif SOLAR_FAIL_CASE == 26
solar::kernel::ThreadConfiguration invalid_raw_options{
    .priority = solar::kernel::Priority::preemptive<0>(), .options = K_USER};
#elif SOLAR_FAIL_CASE == 27
solar::kernel::ThreadOptions invalid_user_mode{K_USER};
#elif SOLAR_FAIL_CASE == 28
solar::kernel::Stack<std::int32_t, 2> invalid_stack_value;
#elif SOLAR_FAIL_CASE == 29
solar::kernel::Stack<std::uint32_t, 0> invalid_stack_capacity;
#elif SOLAR_FAIL_CASE == 30
solar::kernel::Heap<1> invalid_heap_size;
#elif SOLAR_FAIL_CASE == 31
solar::kernel::Heap<128, 3> invalid_heap_alignment;
#elif SOLAR_FAIL_CASE == 32
void invalid_native_access(solar::kernel::Heap<128>& heap)
{
    (void)heap.native_handle();
}
#elif SOLAR_FAIL_CASE == 33
solar::kernel::Heap<128> heap;
solar::kernel::HeapResource implicit_failure_policy{heap.ref()};
#elif SOLAR_FAIL_CASE == 34
solar::kernel::AsyncMailboxSend<std::string> invalid_async_message{"not byte-safe"};
#else
#error SOLAR_DIAGNOSTIC_UNKNOWN_KERNEL_FAILURE_CASE
#endif

int main()
{
    return 0;
}
```
