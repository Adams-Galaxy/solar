## CMakeLists.txt
```
cmake_minimum_required(VERSION 3.20.0)

list(APPEND ZEPHYR_EXTRA_MODULES ${CMAKE_CURRENT_LIST_DIR}/../../..)

find_package(Zephyr REQUIRED HINTS $ENV{ZEPHYR_BASE})
project(solar_inspection_disabled_tests LANGUAGES CXX)

target_sources(app PRIVATE src/main.cpp)
target_compile_features(app PRIVATE cxx_std_23)
set_target_properties(app PROPERTIES CXX_EXTENSIONS OFF)
```

## prj.conf
```kconfig
CONFIG_ZTEST=y
CONFIG_CPP=y
CONFIG_STD_CPP23=y
CONFIG_REQUIRES_FULL_LIBCPP=y
CONFIG_CPP_EXCEPTIONS=n
CONFIG_CPP_RTTI=n
CONFIG_COMPILER_WARNINGS_AS_ERRORS=y
CONFIG_SOLAR=y
CONFIG_SOLAR_INSPECTION=n
```

## src/main.cpp
```c
#include <zephyr/ztest.h>

#include <solar/solar.hpp>

namespace fixture
{
struct App
{
    static constexpr solar::component::Descriptor descriptor{.name = "app"};
};
using System = solar::System<solar::Blueprint<solar::Facilities<App>>>;
} // namespace fixture

SOLAR_BIND_SYSTEM(fixture::System);

static_assert(fixture::System::InspectionCatalog::size == 0);
static_assert(!solar::contains_v<solar::inspection::Facility, fixture::System::Builtins>);

ZTEST(inspection_disabled, test_direct_system_remains_available)
{
    constexpr auto components = solar::graph::components();
    zassert_equal(components.size(), 1);
}

ZTEST_SUITE(inspection_disabled, nullptr, nullptr, nullptr, nullptr, nullptr);
```
