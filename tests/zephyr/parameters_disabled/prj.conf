## CMakeLists.txt
```
cmake_minimum_required(VERSION 3.20.0)

list(APPEND ZEPHYR_EXTRA_MODULES ${CMAKE_CURRENT_LIST_DIR}/../../..)

find_package(Zephyr REQUIRED HINTS $ENV{ZEPHYR_BASE})
project(solar_parameters_disabled_tests LANGUAGES CXX)

target_sources(app PRIVATE src/main.cpp)
target_compile_features(app PRIVATE cxx_std_23)
set_target_properties(app PROPERTIES CXX_EXTENSIONS OFF)
```

## prj.conf
```kconfig
CONFIG_ZTEST=y
CONFIG_CPP=y
CONFIG_STD_CPP23=y
CONFIG_REQUIRES_FULL_LIBCPP=y
CONFIG_CPP_EXCEPTIONS=n
CONFIG_CPP_RTTI=n
CONFIG_COMPILER_WARNINGS_AS_ERRORS=y
CONFIG_SOLAR=y
CONFIG_SOLAR_EXECUTION=y
CONFIG_SOLAR_PARAMETERS=n
```

## src/main.cpp
```c
#include <zephyr/ztest.h>

#include <solar/parameters.hpp>
#include <solar/solar.hpp>

namespace fixture
{

struct Parameter
{
    using Value = int;
    static constexpr solar::parameters::Descriptor descriptor{.name = "disabled.parameter"};
    static constexpr Value default_value = 1;
};

using System = solar::System<solar::Blueprint<>>;

} // namespace fixture

SOLAR_BIND_SYSTEM(fixture::System);

ZTEST(solar_parameters_disabled, test_disabled_frontend_is_explicit)
{
    auto before_boot = solar::parameters::get<fixture::Parameter>();
    zassert_false(before_boot.has_value());
    zassert_equal(before_boot.error().reason, solar::parameters::Reason::NotReady);

    auto boot = fixture::System::boot();
    zassert_true(boot.has_value());

    auto value = solar::parameters::get<fixture::Parameter>();
    zassert_false(value.has_value());
    zassert_equal(value.error().reason, solar::parameters::Reason::Disabled);

    auto stopped = fixture::System::stop();
    zassert_true(stopped.has_value());
}

ZTEST_SUITE(solar_parameters_disabled, nullptr, nullptr, nullptr, nullptr, nullptr);
```
