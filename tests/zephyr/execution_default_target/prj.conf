## CMakeLists.txt
```
cmake_minimum_required(VERSION 3.20.0)

list(APPEND ZEPHYR_EXTRA_MODULES ${CMAKE_CURRENT_LIST_DIR}/../../..)

find_package(Zephyr REQUIRED HINTS $ENV{ZEPHYR_BASE})
project(solar_execution_default_target LANGUAGES CXX)

target_sources(app PRIVATE src/main.cpp)
target_compile_features(app PRIVATE cxx_std_23)
set_target_properties(app PROPERTIES CXX_EXTENSIONS OFF)
```

## prj.conf
```kconfig
CONFIG_CPP=y
CONFIG_STD_CPP23=y
CONFIG_REQUIRES_FULL_LIBCPP=y
CONFIG_ZTEST=y
CONFIG_CPP_EXCEPTIONS=n
CONFIG_CPP_RTTI=n
CONFIG_SOLAR=y
CONFIG_SOLAR_EXECUTION=y
CONFIG_SOLAR_EXECUTION_DEFAULT_SYSTEM_WORKQUEUE=y
```

## src/main.cpp
```c
#include <atomic>

#include <zephyr/kernel.h>
#include <zephyr/ztest.h>

#include <solar/solar.hpp>

namespace fixture
{

inline std::atomic_uint runs{};

struct Behavior
{
    static void execute()
    {
        ++runs;
    }
};

using DefaultTask = solar::execution::OnDemand<"default-task", Behavior>;
using System = solar::System<solar::Blueprint<solar::Execution<DefaultTask>>>;

} // namespace fixture

SOLAR_BIND_SYSTEM(fixture::System);

ZTEST(solar_execution_default, test_omitted_target_resolves_to_system_queue)
{
    auto boot = solar::boot();
    zassert_true(boot.has_value());
    auto submitted = solar::execution::submit<fixture::DefaultTask>();
    zassert_true(submitted.has_value());
    zassert_equal(submitted->target_kind, solar::execution::TargetKind::SystemWorkQueue);
    for (int attempt = 0; attempt < 100 && fixture::runs.load(std::memory_order_acquire) == 0;
         ++attempt) {
        k_sleep(K_MSEC(1));
    }
    zassert_equal(fixture::runs.load(std::memory_order_acquire), 1);
    const auto record = solar::execution::registration<fixture::DefaultTask>();
    zassert_true(record.has_value());
    zassert_equal(record->target_source, solar::execution::TargetSource::KconfigDefault);
    zassert_true(solar::stop().has_value());
}

ZTEST_SUITE(solar_execution_default, nullptr, nullptr, nullptr, nullptr, nullptr);
```
