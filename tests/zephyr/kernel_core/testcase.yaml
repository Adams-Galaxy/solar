## tests/zephyr/kernel_core/testcase.yaml
```yaml
tests:
  solar.kernel.core:
    ignore_faults: true
    platform_allow:
      - native_sim/native/64
      - qemu_cortex_m3
    tags:
      - solar
      - kernel
      - isr
  solar.kernel.core.assertions_disabled:
    ignore_faults: true
    platform_allow:
      - native_sim/native/64
    extra_configs:
      - CONFIG_ASSERT=n
    tags:
      - solar
      - kernel
      - assertions-disabled
```

## tests/zephyr/kernel_execution/testcase.yaml
```yaml
tests:
  solar.kernel.execution:
    platform_allow:
      - native_sim/native/64
      - qemu_cortex_m3
    tags:
      - solar
      - kernel
      - thread
      - work
```

## tests/zephyr/kernel_fatal_bridge/testcase.yaml
```yaml
tests:
  solar.kernel.fatal_bridge:
    ignore_faults: true
    platform_allow:
      - native_sim/native/64
    harness: console
    harness_config:
      type: one_line
      regex:
        - "SOLAR_FATAL_BRIDGE_OBSERVED_REAL_OOPS"
    tags:
      - solar
      - kernel
      - fatal
```

## tests/zephyr/kernel_priority_matrix/testcase.yaml
```yaml
tests:
  solar.kernel.priority.mixed:
    build_only: true
    platform_allow:
      - native_sim/native/64
    tags:
      - solar
      - kernel
      - priority
  solar.kernel.priority.cooperative_only:
    build_only: true
    platform_allow:
      - native_sim/native/64
    extra_configs:
      - CONFIG_NUM_COOP_PRIORITIES=4
      - CONFIG_NUM_PREEMPT_PRIORITIES=0
      - CONFIG_MAIN_THREAD_PRIORITY=-1
      - CONFIG_SYSTEM_WORKQUEUE_PRIORITY=-1
      - CONFIG_SOLAR_APPLICATION_DEFAULT_SERVICE_PRIORITY_COOPERATIVE=y
      - CONFIG_SOLAR_APPLICATION_DEFAULT_SERVICE_PRIORITY_LEVEL=0
    tags:
      - solar
      - kernel
      - priority
  solar.kernel.priority.preemptive_only:
    build_only: true
    platform_allow:
      - native_sim/native/64
    extra_configs:
      - CONFIG_NUM_COOP_PRIORITIES=0
      - CONFIG_NUM_PREEMPT_PRIORITIES=4
      - CONFIG_MAIN_THREAD_PRIORITY=0
      - CONFIG_SYSTEM_WORKQUEUE_PRIORITY=1
    tags:
      - solar
      - kernel
      - priority
  solar.kernel.priority.reduced_mixed:
    build_only: true
    platform_allow:
      - native_sim/native/64
    extra_configs:
      - CONFIG_NUM_COOP_PRIORITIES=3
      - CONFIG_NUM_PREEMPT_PRIORITIES=5
    tags:
      - solar
      - kernel
      - priority
  solar.kernel.priority.metairq:
    build_only: true
    platform_allow:
      - native_sim/native/64
    extra_configs:
      - CONFIG_NUM_COOP_PRIORITIES=4
      - CONFIG_NUM_PREEMPT_PRIORITIES=4
      - CONFIG_NUM_METAIRQ_PRIORITIES=1
    tags:
      - solar
      - kernel
      - priority
```

## tests/zephyr/lifecycle/testcase.yaml
```yaml
tests:
  solar.lifecycle.relaxed:
    platform_allow:
      - native_sim/native/64
    tags:
      - solar
      - lifecycle
      - relaxed
  solar.lifecycle.strict:
    extra_configs:
      - CONFIG_SOLAR_STRICT_CATALOG_BINDING=y
    platform_allow:
      - native_sim/native/64
    tags:
      - solar
      - lifecycle
      - strict
```

## tests/zephyr/logging_availability/testcase.yaml
```yaml
tests:
  solar.logging.availability.relaxed:
    tags:
      - solar
      - logging
    platform_allow:
      - native_sim/native/64
    integration_platforms:
      - native_sim/native/64
  solar.logging.availability.strict:
    tags:
      - solar
      - logging
    platform_allow:
      - native_sim/native/64
    extra_configs:
      - CONFIG_SOLAR_STRICT_CATALOG_BINDING=y
```

## tests/zephyr/logging_disabled/testcase.yaml
```yaml
tests:
  solar.logging.disabled:
    tags:
      - solar
      - logging
    platform_allow:
      - native_sim/native/64
    integration_platforms:
      - native_sim/native/64
```

## tests/zephyr/metrics/testcase.yaml
```yaml
tests:
  solar.metrics.relaxed:
    tags:
      - solar
      - metrics
    platform_allow:
      - native_sim/native/64
  solar.metrics.strict:
    tags:
      - solar
      - metrics
    platform_allow:
      - native_sim/native/64
    extra_configs:
      - CONFIG_SOLAR_STRICT_CATALOG_BINDING=y
```

## tests/zephyr/metrics_availability/testcase.yaml
```yaml
tests:
  solar.metrics.availability.relaxed:
    tags:
      - solar
      - metrics
    platform_allow:
      - native_sim/native/64
  solar.metrics.availability.strict:
    tags:
      - solar
      - metrics
    platform_allow:
      - native_sim/native/64
    extra_configs:
      - CONFIG_SOLAR_STRICT_CATALOG_BINDING=y
```

## tests/zephyr/metrics_disabled/testcase.yaml
```yaml
tests:
  solar.metrics.disabled:
    tags:
      - solar
      - metrics
    platform_allow:
      - native_sim/native/64
```

## tests/zephyr/metrics_policy/testcase.yaml
```yaml
tests:
  solar.metrics.policy.default-kconfig:
    tags:
      - solar
      - metrics
    platform_allow:
      - native_sim/native/64
  solar.metrics.policy.alternate-kconfig:
    tags:
      - solar
      - metrics
    platform_allow:
      - native_sim/native/64
    extra_configs:
      - CONFIG_SOLAR_METRICS_DEFAULT_CONCURRENCY_SPINLOCKED=y
      - CONFIG_SOLAR_METRICS_DEFAULT_OVERFLOW_REJECT=y
```

## tests/zephyr/parameters/testcase.yaml
```yaml
tests:
  solar.parameters.relaxed:
    tags:
      - solar
      - parameters
    platform_allow:
      - native_sim/native/64
  solar.parameters.strict:
    tags:
      - solar
      - parameters
    platform_allow:
      - native_sim/native/64
    extra_configs:
      - CONFIG_SOLAR_STRICT_CATALOG_BINDING=y
  solar.parameters.settings-adapter:
    tags:
      - solar
      - parameters
      - settings
    platform_allow:
      - native_sim/native/64
    extra_configs:
      - CONFIG_SETTINGS=y
      - CONFIG_SOLAR_PARAMETERS_ZEPHYR_SETTINGS=y
```

## tests/zephyr/parameters_availability/testcase.yaml
```yaml
tests:
  solar.parameters.availability.relaxed:
    tags:
      - solar
      - parameters
    platform_allow:
      - native_sim/native/64
  solar.parameters.availability.strict:
    tags:
      - solar
      - parameters
    platform_allow:
      - native_sim/native/64
    extra_configs:
      - CONFIG_SOLAR_STRICT_CATALOG_BINDING=y
  solar.parameters.availability.persistence-disabled:
    tags:
      - solar
      - parameters
    platform_allow:
      - native_sim/native/64
    extra_configs:
      - CONFIG_SOLAR_PARAMETERS_PERSISTENCE=n
```

## tests/zephyr/parameters_disabled/testcase.yaml
```yaml
tests:
  solar.parameters.disabled:
    tags:
      - solar
      - parameters
    platform_allow:
      - native_sim/native/64
```

## tests/zephyr/parameters_policy/testcase.yaml
```yaml
tests:
  solar.parameters.policy.default-kconfig:
    tags:
      - solar
      - parameters
    platform_allow:
      - native_sim/native/64
  solar.parameters.policy.alternate-kconfig:
    tags:
      - solar
      - parameters
    platform_allow:
      - native_sim/native/64
    extra_configs:
      - CONFIG_SOLAR_PARAMETERS_DEFAULT_LOAD_FAIL_BOOT=y
      - CONFIG_SOLAR_PARAMETERS_DEFAULT_STOP_CANCEL=y
```

## tests/zephyr/remote_adapters/testcase.yaml
```yaml
tests:
  solar.remote.adapters.relaxed:
    platform_allow:
      - native_sim/native/64
    integration_platforms:
      - native_sim/native/64
    tags:
      - solar
      - remote
      - adapters
  solar.remote.adapters.strict:
    platform_allow:
      - native_sim/native/64
    integration_platforms:
      - native_sim/native/64
    extra_configs:
      - CONFIG_SOLAR_STRICT_CATALOG_BINDING=y
    tags:
      - solar
      - remote
      - adapters
      - strict
```

## tests/zephyr/remote_chunked_best_effort_stream/testcase.yaml
```yaml
tests:
  solar.remote.chunked_best_effort_stream:
    tags:
      - solar
      - remote
      - protocol
    platform_allow:
      - native_sim/native/64
```

## tests/zephyr/remote_chunked_reliable_stream/testcase.yaml
```yaml
tests:
  solar.remote.chunked_reliable_stream:
    tags:
      - solar
      - remote
      - protocol
    platform_allow:
      - native_sim/native/64
```

## tests/zephyr/remote_disabled/testcase.yaml
```yaml
tests:
  solar.remote.disabled:
    tags:
      - solar
      - remote
    platform_allow:
      - native_sim/native/64
    integration_platforms:
      - native_sim/native/64
```

## tests/zephyr/remote_fragmentation/testcase.yaml
```yaml
tests:
  solar.remote.fragmentation.relaxed:
    platform_allow:
      - native_sim/native/64
    integration_platforms:
      - native_sim/native/64
    tags:
      - solar
      - remote
      - fragmentation
  solar.remote.fragmentation.strict:
    platform_allow:
      - native_sim/native/64
    integration_platforms:
      - native_sim/native/64
    extra_configs:
      - CONFIG_SOLAR_STRICT_CATALOG_BINDING=y
    tags:
      - solar
      - remote
      - fragmentation
      - strict
```

## tests/zephyr/remote_in_stream/testcase.yaml
```yaml
tests:
  solar.remote.in_stream.relaxed:
    platform_allow:
      - native_sim/native/64
    integration_platforms:
      - native_sim/native/64
    tags:
      - solar
      - remote
      - in_stream
  solar.remote.in_stream.strict:
    platform_allow:
      - native_sim/native/64
    integration_platforms:
      - native_sim/native/64
    extra_configs:
      - CONFIG_SOLAR_STRICT_CATALOG_BINDING=y
    tags:
      - solar
      - remote
      - in_stream
      - strict
```

## tests/zephyr/remote_link/testcase.yaml
```yaml
tests:
  solar.remote.link.fake_dma:
    platform_allow:
      - native_sim/native/64
    integration_platforms:
      - native_sim/native/64
    tags:
      - solar
      - remote
      - link
```

## tests/zephyr/remote_loan/testcase.yaml
```yaml
tests:
  solar.remote.loan.relaxed:
    platform_allow:
      - native_sim/native/64
    integration_platforms:
      - native_sim/native/64
    tags:
      - solar
      - remote
      - loan
  solar.remote.loan.strict:
    platform_allow:
      - native_sim/native/64
    integration_platforms:
      - native_sim/native/64
    extra_configs:
      - CONFIG_SOLAR_STRICT_CATALOG_BINDING=y
    tags:
      - solar
      - remote
      - loan
      - strict
```

## tests/zephyr/remote_manifest/testcase.yaml
```yaml
tests:
  solar.remote.manifest:
    tags:
      - solar
      - remote
      - manifest
    platform_allow:
      - native_sim/native/64
    integration_platforms:
      - native_sim/native/64
```

## tests/zephyr/remote_outbound_credit/testcase.yaml
```yaml
tests:
  solar.remote.outbound_credit:
    tags:
      - solar
      - remote
      - protocol
    platform_allow:
      - native_sim/native/64
```
