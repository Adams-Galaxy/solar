## CMakeLists.txt
```
cmake_minimum_required(VERSION 3.20.0)
list(APPEND ZEPHYR_EXTRA_MODULES ${CMAKE_CURRENT_LIST_DIR}/../../..)
find_package(Zephyr REQUIRED HINTS $ENV{ZEPHYR_BASE})
project(solar_logging_disabled_tests LANGUAGES CXX)
target_sources(app PRIVATE src/main.cpp)
target_compile_features(app PRIVATE cxx_std_23)
set_target_properties(app PROPERTIES CXX_EXTENSIONS OFF)
```

## prj.conf
```kconfig
CONFIG_ZTEST=y
CONFIG_CPP=y
CONFIG_STD_CPP23=y
CONFIG_REQUIRES_FULL_LIBCPP=y
CONFIG_CPP_EXCEPTIONS=n
CONFIG_CPP_RTTI=n
CONFIG_COMPILER_WARNINGS_AS_ERRORS=y
CONFIG_LOG=y
CONFIG_SOLAR=y
CONFIG_SOLAR_LOG=n
```

## src/main.cpp
```c
#include <zephyr/ztest.h>

#include <solar/log.hpp>

struct DisabledSource
{
    static constexpr solar::log::SourceDescriptor descriptor{.name = "disabled-source"};
};

static_assert(!solar::log::available);
static_assert(!solar::log::enabled<DisabledSource, solar::log::Level::Info>);

ZTEST(solar_logging_disabled, test_explicit_use_reports_disabled_without_binding)
{
    auto result = solar::log::info<DisabledSource>("disabled {}", 1U);
    zassert_false(result.has_value());
    zassert_equal(result.error().reason, solar::log::Reason::Disabled);
}

ZTEST_SUITE(solar_logging_disabled, nullptr, nullptr, nullptr, nullptr, nullptr);
```
