## CMakeLists.txt
```
cmake_minimum_required(VERSION 3.20.0)

list(APPEND ZEPHYR_EXTRA_MODULES ${CMAKE_CURRENT_LIST_DIR}/../../..)

find_package(Zephyr REQUIRED HINTS $ENV{ZEPHYR_BASE})
project(solar_bus_disabled_compile_fail LANGUAGES CXX)

target_sources(app PRIVATE src/main.cpp)
target_compile_features(app PRIVATE cxx_std_23)
set_target_properties(app PROPERTIES CXX_EXTENSIONS OFF)
```

## prj.conf
```kconfig
CONFIG_CPP=y
CONFIG_STD_CPP23=y
CONFIG_REQUIRES_FULL_LIBCPP=y
CONFIG_CPP_EXCEPTIONS=n
CONFIG_CPP_RTTI=n
CONFIG_SOLAR=y
CONFIG_SOLAR_EXECUTION=y
CONFIG_SOLAR_BUS=n
```

## src/main.cpp
```c
#include <solar/bus.hpp>
#include <solar/solar.hpp>

namespace
{

struct Message
{
    int value{};
    static constexpr solar::bus::Descriptor descriptor{.name = "disabled.message"};
};

using InvalidSystem = solar::System<solar::Blueprint<solar::Bus<solar::bus::Messages<Message>>>>;

static_assert(InvalidSystem::valid);

} // namespace

int main()
{
    return 0;
}
```
