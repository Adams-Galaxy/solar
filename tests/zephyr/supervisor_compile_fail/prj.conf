## CMakeLists.txt
```
cmake_minimum_required(VERSION 3.20.0)

list(APPEND ZEPHYR_EXTRA_MODULES ${CMAKE_CURRENT_LIST_DIR}/../../..)
find_package(Zephyr REQUIRED HINTS $ENV{ZEPHYR_BASE})
project(solar_supervisor_compile_fail LANGUAGES CXX)

if(NOT DEFINED SOLAR_FAIL_CASE)
    message(FATAL_ERROR "SOLAR_FAIL_CASE must select the expected failure")
endif()

target_compile_definitions(app PRIVATE SOLAR_FAIL_CASE=${SOLAR_FAIL_CASE})
target_sources(app PRIVATE src/main.cpp)
```

## prj.conf
```kconfig
CONFIG_CPP=y
CONFIG_STD_CPP23=y
CONFIG_REQUIRES_FULL_LIBCPP=y
CONFIG_CPP_EXCEPTIONS=n
CONFIG_CPP_RTTI=n
CONFIG_SOLAR=y
CONFIG_SOLAR_EXECUTION=y
CONFIG_SOLAR_HEALTH=y
CONFIG_SOLAR_SUPERVISOR=y
CONFIG_SOLAR_STRICT_CATALOG_BINDING=y
CONFIG_SOLAR_REMOTE_GENERATE_MANIFEST=n
```

## src/main.cpp
```c
#include <solar/solar.hpp>

struct Present
{
    static constexpr solar::component::Descriptor descriptor{.name = "present"};
};

struct Missing
{
    static constexpr solar::component::Descriptor descriptor{.name = "missing"};
};

struct NoRecovery
{
    static constexpr solar::component::Descriptor descriptor{.name = "no-recovery"};
    struct Health
    {};
};

struct NoSafeState
{};

struct NoFeedProvider
{};

#if SOLAR_FAIL_CASE == 1
using Configuration = solar::supervisor::Configuration<
    solar::supervisor::Policy<solar::supervisor::OnFault<Present>>>;
using InvalidSystem = solar::System<solar::Blueprint<solar::Devices<Present>, Configuration>>;
#elif SOLAR_FAIL_CASE == 2
using Configuration = solar::supervisor::Configuration<solar::supervisor::Policy<
    solar::supervisor::OnFault<NoRecovery, solar::supervisor::TryRecover<NoRecovery>>>>;
using InvalidSystem = solar::System<solar::Blueprint<solar::Devices<NoRecovery>, Configuration>>;
#elif SOLAR_FAIL_CASE == 3
using Configuration = solar::supervisor::Configuration<solar::supervisor::Policy<
    solar::supervisor::OnFault<Present, solar::supervisor::EnterSafeState<NoSafeState>>>>;
using InvalidSystem = solar::System<solar::Blueprint<solar::Devices<Present>, Configuration>>;
#elif SOLAR_FAIL_CASE == 4
using Configuration = solar::supervisor::Configuration<solar::supervisor::Watchdog<NoFeedProvider>>;
using InvalidSystem = solar::System<solar::Blueprint<solar::Devices<Present>, Configuration>>;
#elif SOLAR_FAIL_CASE == 5
using Configuration = solar::supervisor::Configuration<
    solar::supervisor::Policy<solar::supervisor::OnFault<Missing, solar::supervisor::Warn>>>;
using InvalidSystem = solar::System<solar::Blueprint<solar::Devices<Present>, Configuration>>;
#else
#error SOLAR_DIAGNOSTIC_UNKNOWN_SUPERVISOR_FAILURE_CASE
#endif

SOLAR_BIND_SYSTEM(InvalidSystem);

int main()
{
    (void)InvalidSystem::boot();
    return 0;
}
```
