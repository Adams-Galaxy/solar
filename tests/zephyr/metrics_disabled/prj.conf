## CMakeLists.txt
```
cmake_minimum_required(VERSION 3.20.0)

list(APPEND ZEPHYR_EXTRA_MODULES ${CMAKE_CURRENT_LIST_DIR}/../../..)

find_package(Zephyr REQUIRED HINTS $ENV{ZEPHYR_BASE})
project(solar_metrics_disabled_tests LANGUAGES CXX)

target_sources(app PRIVATE src/main.cpp)
target_compile_features(app PRIVATE cxx_std_23)
set_target_properties(app PROPERTIES CXX_EXTENSIONS OFF)
```

## prj.conf
```kconfig
CONFIG_ZTEST=y
CONFIG_CPP=y
CONFIG_STD_CPP23=y
CONFIG_REQUIRES_FULL_LIBCPP=y
CONFIG_CPP_EXCEPTIONS=n
CONFIG_CPP_RTTI=n
CONFIG_COMPILER_WARNINGS_AS_ERRORS=y
CONFIG_SOLAR=y
CONFIG_SOLAR_METRICS=n
```

## src/main.cpp
```c
#include <zephyr/ztest.h>

#include <solar/metrics.hpp>
#include <solar/solar.hpp>

namespace fixture
{

struct DisabledCount
{
    using Value = std::uint32_t;
    using Instrument = solar::metrics::Counter;
    using Unit = solar::metrics::units::Count;
    static constexpr solar::metrics::Descriptor descriptor{.name = "disabled-count"};
};

using System = solar::System<solar::Blueprint<>>;

} // namespace fixture

SOLAR_BIND_SYSTEM(fixture::System);

ZTEST(solar_metrics_disabled, test_disabled_frontends_are_explicit_and_storage_free)
{
    static_assert(!solar::metrics::enabled);

    auto before_boot = solar::metrics::inc<fixture::DisabledCount>();
    zassert_false(before_boot.has_value());
    zassert_equal(before_boot.error().reason, solar::metrics::Reason::NotReady);

    auto boot = fixture::System::boot();
    zassert_true(boot.has_value());
    auto disabled = solar::metrics::inc<fixture::DisabledCount>();
    zassert_false(disabled.has_value());
    zassert_equal(disabled.error().reason, solar::metrics::Reason::Disabled);
    zassert_true(solar::metrics::catalog::descriptors().empty());

    zassert_true(fixture::System::stop().has_value());
}

ZTEST_SUITE(solar_metrics_disabled, nullptr, nullptr, nullptr, nullptr, nullptr);
```
