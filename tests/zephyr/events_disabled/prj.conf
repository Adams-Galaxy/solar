## CMakeLists.txt
```
cmake_minimum_required(VERSION 3.20.0)

list(APPEND ZEPHYR_EXTRA_MODULES ${CMAKE_CURRENT_LIST_DIR}/../../..)

find_package(Zephyr REQUIRED HINTS $ENV{ZEPHYR_BASE})
project(solar_events_disabled_tests LANGUAGES CXX)

target_sources(app PRIVATE src/main.cpp)
target_compile_features(app PRIVATE cxx_std_23)
set_target_properties(app PROPERTIES CXX_EXTENSIONS OFF)
```

## prj.conf
```kconfig
CONFIG_ZTEST=y
CONFIG_CPP=y
CONFIG_STD_CPP23=y
CONFIG_REQUIRES_FULL_LIBCPP=y
CONFIG_CPP_EXCEPTIONS=n
CONFIG_CPP_RTTI=n
CONFIG_COMPILER_WARNINGS_AS_ERRORS=y
CONFIG_MAIN_STACK_SIZE=4096
CONFIG_SOLAR=y
CONFIG_SOLAR_EXECUTION=y
CONFIG_SOLAR_BUS=n
CONFIG_SOLAR_PARAMETERS=n
CONFIG_SOLAR_EVENTS=n
```

## src/main.cpp
```c
#include <zephyr/ztest.h>

#include <solar/events.hpp>
#include <solar/solar.hpp>

namespace fixture
{

struct Event
{
    using Payload = std::uint32_t;
    static constexpr solar::events::Descriptor descriptor{.name = "disabled.event"};
};

using System = solar::System<solar::Blueprint<>>;

} // namespace fixture

SOLAR_BIND_SYSTEM(fixture::System);

ZTEST(solar_events_disabled, test_disabled_frontend_is_explicit)
{
    auto before_boot = solar::events::observe<fixture::Event>(1);
    zassert_false(before_boot.has_value());
    zassert_equal(before_boot.error().reason, solar::events::Reason::NotReady);

    auto booted = fixture::System::boot();
    zassert_true(booted.has_value());

    auto observed = solar::events::observe<fixture::Event>(2);
    zassert_false(observed.has_value());
    zassert_equal(observed.error().reason, solar::events::Reason::Disabled);
    zassert_equal(solar::events::descriptors().size(), 0);
    zassert_equal(solar::events::facility_record().last_status, solar::Status::NotSupported);

    auto stopped = fixture::System::stop();
    zassert_true(stopped.has_value());
}

ZTEST_SUITE(solar_events_disabled, nullptr, nullptr, nullptr, nullptr, nullptr);
```
