## CMakeLists.txt
```
cmake_minimum_required(VERSION 3.20.0)

list(APPEND ZEPHYR_EXTRA_MODULES ${CMAKE_CURRENT_LIST_DIR}/../..)

find_package(Zephyr REQUIRED HINTS $ENV{ZEPHYR_BASE})
project(solar_data_pipeline LANGUAGES CXX)
target_sources(app PRIVATE src/main.cpp)
```

## sample.yaml
```
sample:
  name: Solar data pipeline
  description: Integrated Bus, Parameters, Events, Metrics, and Logging example
common:
  tags:
    - solar
    - documentation
  integration_platforms:
    - native_sim/native/64
tests:
  sample.solar.data_pipeline:
    harness: console
    harness_config:
      type: one_line
      regex:
        - "Solar data pipeline passed"
```

## prj.conf
```kconfig
CONFIG_CPP=y
CONFIG_STD_CPP23=y
CONFIG_REQUIRES_FULL_LIBCPP=y
CONFIG_CPP_EXCEPTIONS=n
CONFIG_CPP_RTTI=n
CONFIG_COMPILER_WARNINGS_AS_ERRORS=y
CONFIG_MAIN_STACK_SIZE=4096
CONFIG_SYSTEM_WORKQUEUE_STACK_SIZE=4096
CONFIG_LOG=y
CONFIG_LOG_PRINTK=n
CONFIG_SOLAR=y
CONFIG_SOLAR_EXECUTION=y
CONFIG_SOLAR_BUS=y
CONFIG_SOLAR_PARAMETERS=y
CONFIG_SOLAR_EVENTS=y
CONFIG_SOLAR_METRICS=y
CONFIG_SOLAR_LOG=y
CONFIG_SOLAR_LOG_HISTORY_BYTES=512
CONFIG_SOLAR_LOG_INGRESS_BYTES=768
CONFIG_SOLAR_LOG_MAX_RECORD_BYTES=256
CONFIG_SOLAR_LOG_ELEVATED_RESERVE_BYTES=192
CONFIG_SOLAR_LOG_EMERGENCY_BYTES=128
CONFIG_SOLAR_LOG_RENDER_BUFFER_BYTES=256
```

## src/main.cpp
```c
#include <cstdint>

#include <zephyr/sys/printk.h>

#include <solar/solar.hpp>

namespace app
{

// [declarations]
struct SetTarget
{
    std::int32_t value{};
    static constexpr solar::bus::Descriptor descriptor{.name = "control.set-target"};
};

struct Target
{
    using Value = std::int32_t;
    static constexpr solar::parameters::Descriptor descriptor{.name = "control.target"};
    static constexpr Value default_value = 0;
    using Validation = solar::parameters::Range<-100, 100, solar::parameters::Clamp>;
};

struct CommandsHandled
{
    using Value = std::uint64_t;
    using Instrument = solar::metrics::Counter;
    using Unit = solar::metrics::units::Count;
    static constexpr solar::metrics::Descriptor descriptor{.name = "control.commands-handled"};
};

struct TargetChanged
{
    using Payload = std::int32_t;
    static constexpr solar::events::Descriptor descriptor{
        .name = "control.target-changed",
        .severity = solar::events::Severity::Informational,
        .domain = solar::events::domain::Resource,
    };
};
// [declarations]

// [component]
struct Controller
{
    static constexpr solar::component::Descriptor descriptor{.name = "controller"};
    using Messages = solar::bus::Messages<SetTarget>;
    using Subscriptions = solar::bus::Subscriptions<
        solar::bus::On<SetTarget, solar::bus::delivery::Inline>>;
    using Parameters = solar::parameters::Parameters<Target>;
    using Events = solar::events::Events<TargetChanged>;
    using Metrics = solar::metrics::Metrics<CommandsHandled>;

    static solar::Result<void> handle(const SetTarget& command)
    {
        auto update = solar::parameters::set<Target>(command.value);
        if (!update) {
            return solar::fail<solar::Error>({.status = solar::status_of(update.error())});
        }
        if (auto counted = solar::metrics::inc<CommandsHandled>(); !counted) {
            return solar::fail<solar::Error>({.status = solar::status_of(counted.error())});
        }
        if (auto observed = solar::events::observe<TargetChanged>(update->effective_value);
            !observed) {
            return solar::fail<solar::Error>({.status = solar::status_of(observed.error())});
        }
        if (auto logged =
                solar::log::notice<Controller>("target changed to {}", update->effective_value);
            !logged) {
            return solar::fail<solar::Error>({.status = solar::status_of(logged.error())});
        }
        return {};
    }
};
// [component]

// [system]
using Blueprint = solar::Blueprint<
    solar::Facilities<Controller>,
    solar::log::Configuration<solar::log::Sinks<
        solar::log::To<solar::log::RetainedHistory,
                       solar::log::MinimumLevel<solar::log::Level::Notice>>>>>;
using System = solar::System<Blueprint>;
// [system]

} // namespace app

SOLAR_BIND_SYSTEM(app::System);

int main()
{
    // [flow]
    if (!solar::boot()) {
        return 1;
    }
    if (!solar::bus::emit<app::SetTarget>({.value = 42})) {
        return 2;
    }

    const auto target = solar::parameters::get<app::Target>();
    const auto handled = solar::metrics::get<app::CommandsHandled>();
    const auto latest_log = solar::log::latest();
    if (!target || *target != 42 || !handled || handled->value != 1 || !latest_log) {
        return 3;
    }
    if (!solar::stop()) {
        return 4;
    }
    // [flow]

    printk("Solar data pipeline passed\n");
    return 0;
}
```
