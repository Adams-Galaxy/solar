## examples/first-application/sample.yaml
```yaml
sample:
  name: Solar first application
  description: Smallest complete Solar System with lifecycle and boot handling
common:
  platform_allow:
    - native_sim/native/64
  integration_platforms:
    - native_sim/native/64
  tags:
    - solar
    - documentation
  harness: console
  harness_config:
    type: one_line
    regex:
      - "Solar first application passed"
tests:
  sample.solar.first_application: {}
```

## tests/core/lifecycle/testcase.yaml
```yaml
tests:
  solar.core.lifecycle:
    platform_allow:
      - native_sim/native/64
    tags:
      - solar
      - lifecycle
```

## tests/system/graph_compile_fail/testcase.yaml
```yaml
tests:
  solar.graph.missing_dependency:
    build_only: true
    build_error: true
    extra_args: CASE=MISSING_DEPENDENCY
    platform_allow: native_sim/native/64
  solar.graph.duplicate_component:
    build_only: true
    build_error: true
    extra_args: CASE=DUPLICATE_COMPONENT
    platform_allow: native_sim/native/64
  solar.graph.duplicate_service:
    build_only: true
    build_error: true
    extra_args: CASE=DUPLICATE_SERVICE
    platform_allow: native_sim/native/64
  solar.graph.dependency_cycle:
    build_only: true
    build_error: true
    extra_args: CASE=DEPENDENCY_CYCLE
    platform_allow: native_sim/native/64
```

## tests/system/lifecycle/testcase.yaml
```yaml
tests:
  solar.system.lifecycle:
    platform_allow:
      - native_sim/native/64
    tags:
      - solar
      - lifecycle
      - system
```

## tests/system/shutdown/testcase.yaml
```yaml
tests:
  solar.system.shutdown:
    platform_allow:
      - native_sim/native/64
    tags:
      - solar
      - lifecycle
      - shutdown
```

## tests/zephyr/bus_availability/testcase.yaml
```yaml
tests:
  solar.bus.availability.relaxed:
    tags:
      - solar
      - bus
    platform_allow:
      - native_sim/native/64
  solar.bus.availability.strict:
    tags:
      - solar
      - bus
    platform_allow:
      - native_sim/native/64
    extra_configs:
      - CONFIG_SOLAR_STRICT_CATALOG_BINDING=y
```

## tests/zephyr/bus_disabled/testcase.yaml
```yaml
tests:
  solar.bus.disabled:
    tags:
      - solar
      - bus
    platform_allow:
      - native_sim/native/64
```

## tests/zephyr/bus_shutdown/testcase.yaml
```yaml
tests:
  solar.bus.shutdown:
    tags:
      - solar
      - bus
    platform_allow:
      - native_sim/native/64
```

## tests/zephyr/catalog/testcase.yaml
```yaml
tests:
  solar.catalog.strings:
    platform_allow:
      - native_sim/native/64
    tags:
      - solar
      - catalog
  solar.catalog.stripped:
    extra_configs:
      - CONFIG_SOLAR_DESCRIPTOR_STRINGS=n
    platform_allow:
      - native_sim/native/64
    tags:
      - solar
      - catalog
```

## tests/zephyr/events/testcase.yaml
```yaml
tests:
  solar.events.relaxed:
    tags:
      - solar
      - events
    platform_allow:
      - native_sim/native/64
```

## tests/zephyr/events_availability/testcase.yaml
```yaml
tests:
  solar.events.availability.relaxed:
    tags:
      - solar
      - events
    platform_allow:
      - native_sim/native/64
  solar.events.availability.strict:
    tags:
      - solar
      - events
    platform_allow:
      - native_sim/native/64
    extra_configs:
      - CONFIG_SOLAR_STRICT_CATALOG_BINDING=y
```

## tests/zephyr/events_disabled/testcase.yaml
```yaml
tests:
  solar.events.disabled:
    tags:
      - solar
      - events
    platform_allow:
      - native_sim/native/64
```

## tests/zephyr/events_policy/testcase.yaml
```yaml
tests:
  solar.events.policy.default-kconfig:
    tags:
      - solar
      - events
    platform_allow:
      - native_sim/native/64
  solar.events.policy.alternate-kconfig:
    tags:
      - solar
      - events
    platform_allow:
      - native_sim/native/64
    extra_configs:
      - CONFIG_SOLAR_EVENTS_DEFAULT_RETENTION_TRANSIENT=y
      - CONFIG_SOLAR_EVENTS_DEFAULT_STOP_CANCEL=y
```

## tests/zephyr/execution/testcase.yaml
```yaml
tests:
  solar.execution.relaxed:
    tags:
      - solar
      - execution
    platform_allow:
      - native_sim/native/64
  solar.execution.strict:
    tags:
      - solar
      - execution
    platform_allow:
      - native_sim/native/64
    extra_configs:
      - CONFIG_SOLAR_STRICT_CATALOG_BINDING=y
  solar.execution.no_default_abort:
    tags:
      - solar
      - execution
    platform_allow:
      - native_sim/native/64
    extra_configs:
      - CONFIG_SOLAR_SERVICE_ABORT_ON_STOP_TIMEOUT=n
      - CONFIG_SOLAR_EXECUTOR_ABORT_ON_STOP_TIMEOUT=n
```

## tests/zephyr/execution_default_target/testcase.yaml
```yaml
tests:
  solar.execution.default_system_workqueue:
    tags:
      - solar
      - execution
    platform_allow:
      - native_sim/native/64
```

## tests/zephyr/hardware_explicit/testcase.yaml
```yaml
tests:
  solar.hardware.explicit:
    tags:
      - solar
      - hardware
      - devicetree
    platform_allow:
      - native_sim/native/64
    integration_platforms:
      - native_sim/native/64
```

## tests/zephyr/hardware_foundation/testcase.yaml
```yaml
tests:
  solar.hardware.foundation.native:
    tags:
      - solar
      - hardware
      - gpio
    platform_allow:
      - native_sim/native/64
    integration_platforms:
      - native_sim/native/64
  solar.hardware.foundation.teensy40:
    tags:
      - solar
      - hardware
      - devicetree
    platform_allow:
      - teensy40
    build_only: true
```

## tests/zephyr/hardware_target_compile/testcase.yaml
```yaml
tests:
  solar.hardware.drivers.teensy40:
    tags:
      - solar
      - hardware
      - drivers
    platform_allow:
      - teensy40
    build_only: true
```

## tests/zephyr/health/testcase.yaml
```yaml
tests:
  solar.health.relaxed:
    platform_allow:
      - native_sim/native/64
    tags:
      - solar
      - health
  solar.health.strict:
    extra_configs:
      - CONFIG_SOLAR_STRICT_CATALOG_BINDING=y
    platform_allow:
      - native_sim/native/64
    tags:
      - solar
      - health
      - strict
```

## tests/zephyr/health_availability/testcase.yaml
```yaml
tests:
  solar.health.availability:
    platform_allow:
      - native_sim/native/64
    tags:
      - solar
      - health
      - availability
```

## tests/zephyr/health_disabled/testcase.yaml
```yaml
tests:
  solar.health.disabled:
    platform_allow:
      - native_sim/native/64
    tags:
      - solar
      - health
      - disabled
```

## tests/zephyr/inspection/testcase.yaml
```yaml
tests:
  solar.inspection.relaxed:
    tags:
      - solar
      - inspection
    platform_allow:
      - native_sim/native/64
  solar.inspection.strict:
    tags:
      - solar
      - inspection
    platform_allow:
      - native_sim/native/64
    extra_configs:
      - CONFIG_SOLAR_STRICT_CATALOG_BINDING=y
```

## tests/zephyr/inspection_disabled/testcase.yaml
```yaml
tests:
  solar.inspection.disabled:
    tags:
      - solar
      - inspection
    platform_allow:
      - native_sim/native/64
```

## tests/zephyr/kernel_availability/testcase.yaml
```yaml
tests:
  solar.kernel.optional_disabled:
    platform_allow:
      - native_sim/native/64
    tags:
      - solar
      - kernel
      - disabled
```

## tests/zephyr/kernel_configuration_matrix/testcase.yaml
```yaml
tests:
  solar.kernel.configuration.scheduler_minimal:
    build_only: true
    platform_allow:
      - qemu_cortex_m3
    extra_configs:
      - CONFIG_SCHED_DEADLINE=n
      - CONFIG_TIMESLICING=n
    tags:
      - solar
      - kernel
      - configuration
  solar.kernel.configuration.no_clock:
    build_only: true
    platform_allow:
      - qemu_cortex_m3
    extra_args:
      - EXTRA_CFLAGS=-DSOLAR_EXPECT_NO_CLOCK
      - EXTRA_CXXFLAGS=-DSOLAR_EXPECT_NO_CLOCK
    extra_configs:
      - CONFIG_SYS_CLOCK_EXISTS=n
    tags:
      - solar
      - kernel
      - configuration
  solar.kernel.configuration.no_multithreading:
    build_only: true
    platform_allow:
      - qemu_cortex_m3
    extra_args:
      - EXTRA_CFLAGS=-DSOLAR_EXPECT_NO_MULTITHREADING
      - EXTRA_CXXFLAGS=-DSOLAR_EXPECT_NO_MULTITHREADING
    extra_configs:
      - CONFIG_MULTITHREADING=n
    tags:
      - solar
      - kernel
      - configuration
  solar.kernel.configuration.smp:
    build_only: true
    platform_allow:
      - qemu_x86_64
    extra_args:
      - EXTRA_CFLAGS=-DSOLAR_EXPECT_SMP
      - EXTRA_CXXFLAGS=-DSOLAR_EXPECT_SMP
    extra_configs:
      - CONFIG_SMP=y
      - CONFIG_MP_MAX_NUM_CPUS=2
    tags:
      - solar
      - kernel
      - configuration
      - smp
```
